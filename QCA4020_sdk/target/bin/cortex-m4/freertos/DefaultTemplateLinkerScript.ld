/* RAM_START  = 0x10000000; */
/* RAM_LENGTH = 0x000B8000; */
/* XIP_START  = 0x10100000; */
/* XIP_LENGTH = 0x00080000; */

MEMORY
{
 RAM_AON_PATCHROM_RO_MEMORY                        (W)  : ORIGIN = 0x10001600, LENGTH = 0x4c0
 RAM_AON_RO_MEMORY                                 (W)  : ORIGIN = 0x10001ac0, LENGTH = 0x140
 RAM_AON_ROM_PATCHTABLE_RW_MEMORY                  (W)  : ORIGIN = 0x10001c00, LENGTH = 0x180
 RAM_AON_DATA_MEMORY                               (W)  : ORIGIN = 0x10001dc0, LENGTH = 0x240

 RAM_SOM_BSP_ROM_PATCHTABLE_RW_MEMORY              (W)  : ORIGIN = 0x10002f00, LENGTH = 0xd00
 RAM_SOM_BSP_DATA_MEMORY                           (W)  : ORIGIN = 0x10003c00, LENGTH = 0x500
 RAM_SOM_BSP_ROM2RAM_INDIRECTION_TABLE_RW_MEMORY   (W)  : ORIGIN = 0x10004100, LENGTH = 0x40
 RAM_SOM_DEVCFG_DATA_RW_MEMORY                     (W)  : ORIGIN = 0x10004140, LENGTH = 0x7c0

 RAM_SOM_BSP_PATCHROM_RO_MEMORY                    (RX) : ORIGIN = 0x10004900, LENGTH = 0xe00
 RAM_BSP_VENEER_RO_MEMORY                          (RX) : ORIGIN = 0x10005700, LENGTH = 0x900
 RAM_SOM_BSP_RO_MEMORY                             (RX) : ORIGIN = 0x10006000, LENGTH = 0x1600

 RAM_SOM_BSP_DIAG_BUF_MEMORY                       (W)  : ORIGIN = 0x1000e400, LENGTH = 0x280
 RAM_SOM_BSP_HEAP_MEMORY                           (W)  : ORIGIN = 0x1000e680, LENGTH = 0x1200
 RAM_SOM_BSP_STACK_MEMORY                          (W)  : ORIGIN = 0x1000f880, LENGTH = 0x780

 RAM_SOM_APPS_RO_MEMORY                            (RX) : ORIGIN = 0x10007600, LENGTH = 0x5a00
 RAM_SOM_APPS_DATA_MEMORY                          (W)  : ORIGIN = 0x1000d000, LENGTH = 0x1400

 RAM_FOM_BSP_ROM_PATCHTABLE_RW_MEMORY              (W)  : ORIGIN = 0x10013400, LENGTH = 0x3400
 RAM_FOM_BSP_ROM2RAM_INDIRECTION_TABLE_RW_0_MEMORY (W)  : ORIGIN = 0x10016800, LENGTH = 0x200
 RAM_FOM_BSP_ROM2RAM_INDIRECTION_TABLE_RW_1_MEMORY (W)  : ORIGIN = 0x10016a00, LENGTH = 0x200
 RAM_FOM_DEVCFG_DATA_RW_MEMORY                     (W)  : ORIGIN = 0x1001d400, LENGTH = 0xc00
 RAM_FOM_BSP_DATA_MEMORY                           (W)  : ORIGIN = 0x10016c00, LENGTH = 0x6800
 RAM_FOM_BSP_STACK_MEMORY                          (W)  : ORIGIN = 0x100af800, LENGTH = 0x800

 RAM_SBL_RAMDUMP_MEMORY                            (W)  : ORIGIN = 0x1001e000, LENGTH = 0x2000

 RAM_FOM_BSP_PATCHROM_RO_MEMORY                    (RX) : ORIGIN = 0x10020000, LENGTH = 0x5000
 RAM_FOM_BSP_RO_MEMORY                             (RX) : ORIGIN = 0x10025000, LENGTH = 0x21000
 RAM_FOM_APPS_RO_MEMORY                            (RX) : ORIGIN = 0x10046000, LENGTH = 0x3a000
 RAM_FOM_APPS_DATA_MEMORY                          (W)  : ORIGIN = 0x10080000, LENGTH = 0x10000

 RAM_SBL_RO_MEMORY                                 (RX) : ORIGIN = 0x100a0000, LENGTH = 0x2000
 RAM_SBL_RW_MEMORY                                 (W)  : ORIGIN = 0x100a2000, LENGTH = 0x6000
 RAM_SBL_ZI_MEMORY                                 (W)  : ORIGIN = 0x100a8000, LENGTH = 0x2000
 SBL_LOG_META_INFO_RW_MEMORY                       (W)  : ORIGIN = 0x100aa000, LENGTH = 0x40
 SBL_LOG_BUF_RW_MEMORY                             (W)  : ORIGIN = 0x100aa040, LENGTH = 0x1000
 XIP_RO_MEMORY                                     (RX) : ORIGIN = 0x1000000, LENGTH = 0x180000
 RAM_DIAG_STRING_RO_MEMORY                         (W)  : ORIGIN = 0x40000000,LENGTH = 0x2000
}

PHDRS
{
   XIP_SEGMENT                         PT_LOAD;
   RAM_AON_PATCHABLE_RW_SEGMENT        PT_LOAD;
   RAM_AON_PATCHABLE_RO_SEGMENT        PT_LOAD;
   RAM_AON_RO_SEGMENT               PT_LOAD;
   RAM_AON_DATA_SEGMENT             PT_LOAD;
   RAM_SOM_PATCH_DATA_SEGMENT    PT_LOAD;
   RAM_SOM_BSP_CODE_SEGMENT      PT_LOAD;
   RAM_SOM_BSP_DATA_SEGMENT      PT_LOAD;
   RAM_SOM_PATCHROM_CODE_SEGMENT PT_LOAD;
   RAM_SOM_APPS_CODE_SEGMENT     PT_LOAD;
   RAM_SOM_APPS_DATA_SEGMENT     PT_LOAD;
   RAM_FOM_PATCH_DATA_SEGMENT    PT_LOAD;
   RAM_FOM_BSP_DATA_SEGMENT      PT_LOAD;
   RAM_FOM_BSP_CODE_SEGMENT      PT_LOAD;
   RAM_FOM_PATCHROM_CODE_SEGMENT PT_LOAD;
   RAM_BSP_VENEER_SEGMENT        PT_LOAD;
   RAM_FOM_APPS_CODE_SEGMENT     PT_LOAD;
   RAM_FOM_APPS_DATA_SEGMENT     PT_LOAD;
   RAM_SBL_RAMDUMP_SEGMENT       PT_LOAD;
   RAM_SBL_DATA_SEGMENT          PT_LOAD;
   RAM_SBL_CODE_SEGMENT          PT_LOAD;
   RAM_DIAG_STRING_SEGMENT       PT_LOAD;   
   EXIDX_SEGMENT                 0x70000001 FLAGS(4);
}

SECTIONS
{
   /* RAM_AON_CONFIG_SEGMENT */
    RAM_AON_PATCHABLE_RW_REGION :
   {
      *(RAM_AON_BSP_RW_SECTION)
      [RAM AON SYS RW PATCH]
   } >RAM_AON_ROM_PATCHTABLE_RW_MEMORY : RAM_AON_PATCHABLE_RW_SEGMENT

   RAM_AON_PATCHABLE_RO_REGION :
   {
      [RAM AON SYS RO PATCH]
      *(RAM_AON_BSP_RO_SECTION)
   } >RAM_AON_PATCHROM_RO_MEMORY : RAM_AON_PATCHABLE_RO_SEGMENT

   RAM_AON_RO_REGION :
   {
      *(RAM_AON_BSP_RO_SECTION)
      [RAM AON SYS RO NORMAL]
   } >RAM_AON_RO_MEMORY : RAM_AON_RO_SEGMENT

   RAM_AON_ROM2RAM_INDIRECTION_TABLE_RW_REGION :
   {
      *(RAM_AON_ROM2RAM_INDIRECTION_TABLE_RW_SECTION)
   } >RAM_AON_DATA_MEMORY : RAM_AON_DATA_SEGMENT

   RAM_AON_MOM_RW_REGION :
   {
      *(RAM_AON_MOM_RW_SECTION)
      [RAM AON SYS RW NORMAL]
   } >RAM_AON_DATA_MEMORY : RAM_AON_DATA_SEGMENT

   /* RAM_AON_CONFIG_SEGMENT */
   RAM_AON_MOM_ZI_REGION :
   {
      *(RAM_AON_MOM_ZI_SECTION)
      [RAM AON SYS ZI NORMAL]
   } >RAM_AON_DATA_MEMORY : RAM_AON_DATA_SEGMENT

   /* RAM_SOM_PATCH_DATA_SEGMENT */
   RAM_SOM_BSP_ROM_PATCHTABLE_RW_REGION :
   {
      *(RAM_SOM_BSP_ROM_PATCHTABLE_RW_SECTION)
      [RAM SOM SYS RW PATCH]
   } >RAM_SOM_BSP_ROM_PATCHTABLE_RW_MEMORY : RAM_SOM_PATCH_DATA_SEGMENT

   /* RAM_SOM_BSP_DATA_SEGMENT */
   VECTOR_TABLE_RW_REGION :
   {
      *(VECTOR_TABLE_RW_SECTION)
   } >RAM_SOM_BSP_DATA_MEMORY : RAM_SOM_BSP_DATA_SEGMENT

   RAM_SOM_BSP_ROM2RAM_INDIRECTION_TABLE_RW_REGION :
   {
      *(RAM_SOM_BSP_ROM2RAM_INDIRECTION_TABLE_RW_SECTION)
      [RAM SOM SYS RW ROM2RAM]
   } >RAM_SOM_BSP_ROM2RAM_INDIRECTION_TABLE_RW_MEMORY : RAM_SOM_BSP_DATA_SEGMENT

   RAM_SOM_BSP_RW_REGION :
   {
      *(RAM_SOM_BSP_RW_SECTION)
      [RAM SOM SYS RW NORMAL]
   } >RAM_SOM_BSP_DATA_MEMORY : RAM_SOM_BSP_DATA_SEGMENT

   RAM_SOM_BSP_ZI_REGION :
   {
      _RAM_SOM_BSP_ZI_START = .;
      *(.bss.RAM_SOM_BSP_ZI_SECTION)
      [RAM SOM SYS ZI NORMAL]
	  [RAM SOM SYS ZI PATCH]
      _RAM_SOM_BSP_ZI_END = .;      
   } >RAM_SOM_BSP_DATA_MEMORY : RAM_SOM_BSP_DATA_SEGMENT

   RAM_SOM_DEVCFG_DATA_RW_REGION :
   {
      *(RAM_SOM_DEVCFG_DATA_RW_SECTION)
      [RAM SOM SYS RO DEVCFG]
      [RAM SOM SYS RW DEVCFG]
   } >RAM_SOM_DEVCFG_DATA_RW_MEMORY : RAM_SOM_BSP_DATA_SEGMENT

   RAM_SOM_BSP_HEAP_ZI_REGION :
   {
      *(RAM_SOM_BSP_HEAP_ZI_SECTION)
      [RAM SOM SYS ZI HEAP]
   } >RAM_SOM_BSP_HEAP_MEMORY : RAM_SOM_BSP_DATA_SEGMENT

   RAM_SOM_BSP_STACK_ZI_REGION :
   {
      *(.bss.RAM_SOM_BSP_STACK_ZI_SECTION)
      [RAM SOM SYS ZI STACK]
   } >RAM_SOM_BSP_STACK_MEMORY : RAM_SOM_BSP_DATA_SEGMENT

   /* RAM_SOM_BSP_CODE_SEGMENT */
   RAM_SOM_BSP_RO_REGION :
   {
      *(RAM_SOM_BSP_RO_SECTION)
      [RAM SOM SYS RO NORMAL]
      [RAM SOM SYS RO ROM2RAM]      
   } >RAM_SOM_BSP_RO_MEMORY : RAM_SOM_BSP_CODE_SEGMENT

   /* RAM_SOM_PATCHROM_CODE_SEGMENT */
   RAM_SOM_BSP_PATCHROM_RO_REGION :
   {
      *(RAM_SOM_BSP_PATCHROM_RO_SECTION)
      [RAM SOM SYS RO PATCH]
   } >RAM_SOM_BSP_PATCHROM_RO_MEMORY : RAM_SOM_PATCHROM_CODE_SEGMENT

   /* RAM_BSP_VENEER_SEGMENT */
   RAM_BSP_VENEER_RO_REGION :
   {
      [RAM SOM SYS RO VENEER]
   } >RAM_BSP_VENEER_RO_MEMORY : RAM_BSP_VENEER_SEGMENT

   /* RAM_SOM_APPS_CODE_SEGMENT */
   RAM_SOM_APPS_RO_REGION :
   {
      *(RAM_SOM_APPS_RO_SECTION)
      [RAM SOM APPS RO NORMAL]
      [RAM SOM APP RO NORMAL]
   } >RAM_SOM_APPS_RO_MEMORY : RAM_SOM_APPS_CODE_SEGMENT

   /* RAM_SOM_APPS_DATA_SEGMENT */
   RAM_SOM_APPS_RW_REGION :
   {
     *(RAM_SOM_APPS_RW_SECTION)
     [RAM SOM APPS RW NORMAL]
     [RAM SOM APP RW NORMAL]
   } >RAM_SOM_APPS_DATA_MEMORY : RAM_SOM_APPS_DATA_SEGMENT

   RAM_SOM_APPS_ZI_REGION :
   {
     _RAM_SOM_APPS_ZI_START = .;
     *(RAM_SOM_APPS_ZI_SECTION)
     [RAM SOM APPS ZI NORMAL]
     [RAM SOM APP ZI NORMAL]
     _RAM_SOM_APPS_ZI_END = .;     
   } >RAM_SOM_APPS_DATA_MEMORY : RAM_SOM_APPS_DATA_SEGMENT

   /* RAM_FOM_PATCH_DATA_SEGMENT */
   RAM_FOM_BSP_ROM_PATCHTABLE_RW_REGION :
   {
      *(RAM_FOM_BSP_ROM_PATCHTABLE_RW_SECTION)
      [RAM FOM SYS RW PATCH]
   } >RAM_FOM_BSP_ROM_PATCHTABLE_RW_MEMORY : RAM_FOM_PATCH_DATA_SEGMENT

   /* RAM_FOM_BSP_DATA_SEGMENT */
   RAM_FOM_BSP_ROM2RAM_INDIRECTION_TABLE_RW_REGION_0 :
   {
      *(RAM_FOM_BSP_ROM2RAM_INDIRECTION_TABLE_RW_SECTION_0)
      [RAM FOM SYS RW LINK0]
   } >RAM_FOM_BSP_ROM2RAM_INDIRECTION_TABLE_RW_0_MEMORY : RAM_FOM_BSP_DATA_SEGMENT

   RAM_FOM_BSP_ROM2RAM_INDIRECTION_TABLE_RW_REGION_1 :
   {
      *(RAM_FOM_BSP_ROM2RAM_INDIRECTION_TABLE_RW_SECTION_1)
      [RAM FOM SYS RW LINK1]
   } >RAM_FOM_BSP_ROM2RAM_INDIRECTION_TABLE_RW_1_MEMORY : RAM_FOM_BSP_DATA_SEGMENT

   RAM_FOM_DEVCFG_DATA_RW_REGION :
   {
     *(RAM_FOM_DEVCFG_DATA_RW_SECTION)
     [RAM FOM SYS RO DEVCFG]
     [RAM FOM SYS RW DEVCFG]     
   } >RAM_FOM_DEVCFG_DATA_RW_MEMORY : RAM_FOM_BSP_DATA_SEGMENT

   /* RAM_FOM_BSP_STACK_SEGMENT */
   RAM_FOM_BSP_STACK_ZI_REGION :
   {
   } >RAM_FOM_BSP_STACK_MEMORY : RAM_FOM_BSP_STACK_SEGMENT

   /* RAM_FOM_PATCHROM_CODE_SEGMENT */
   RAM_FOM_BSP_PATCHROM_RO_REGION :
   {
     [RAM FOM SYS RO PATCH]
   } >RAM_FOM_BSP_PATCHROM_RO_MEMORY : RAM_FOM_PATCHROM_CODE_SEGMENT

   /* RAM_SBL_RAMDUMP_SEGMENT */
   RAM_SBL_RAMDUMP_RW_REGION :
   {
      *(RAM_SBL_RAMDUMP_RW_SECTION)
      [RAM SBL SYS RW RAMDUMP]
   } >RAM_SBL_RAMDUMP_MEMORY : RAM_SBL_RAMDUMP_SEGMENT

   RAM_SBL_RAMDUMP_ZI_REGION :
   {
      *(RAM_SBL_RAMDUMP_ZI_SECTION)
      [RAM SBL SYS ZI RAMDUMP]
   } >RAM_SBL_RAMDUMP_MEMORY : RAM_SBL_RAMDUMP_SEGMENT

   /* RAM_SBL_CODE_SEGMENT */
   RAM_SBL_RO_REGION :
   {
     *(RAM_SBL_RO_SECTION)
     [RAM SBL SYS RO NORMAL]
   } >RAM_SBL_RO_MEMORY : RAM_SBL_CODE_SEGMENT

   /* RAM_DIAG_STRING_SEGMENT */
   RAM_DIAG_STRING_RO_REGION :
   {
     *(.diagmsg.format)
   } >RAM_DIAG_STRING_RO_MEMORY : RAM_DIAG_STRING_SEGMENT
   
   /* RAM_SBL_DATA_SEGMENT */
   RAM_SBL_RW_REGION : SUBALIGN(4)
   {
      *(.bss.BOOT_HASH_SEGMENT)
      *(RAM_SBL_DATA_SEGMENT_RW_SECTION)
      [RAM SBL SYS RW NORMAL]  
   } >RAM_SBL_RW_MEMORY : RAM_SBL_DATA_SEGMENT

   RAM_SBL_ZI_REGION : SUBALIGN(4)
   {
      *(RAM_SBL_ZI_SECTION)
      [RAM SBL SYS ZI NORMAL]
   } >RAM_SBL_ZI_MEMORY : RAM_SBL_DATA_SEGMENT

   SBL_LOG_META_INFO_RW_SECTION :
   {
   } >SBL_LOG_META_INFO_RW_MEMORY : RAM_SBL_DATA_SEGMENT

   SBL_LOG_BUF_RW_SECTION : SUBALIGN(4)
   {
   } >SBL_LOG_BUF_RW_MEMORY : RAM_SBL_DATA_SEGMENT

   /* XIP_SEGMENT */
   XIP_BSP_RO_REGION :
   {
      *(XIP_BSP_RO_SECTION)
      [XIP FOM SYS RO NORMAL]
      [XIP SBL SYS RO NORMAL]
      [XIP SBL SYS RO RAMDUMP]      
   } >XIP_RO_MEMORY : XIP_SEGMENT

   XIP_OEM_RO_REGION :
   {
      *(XIP_OEM_RO_SECTION)
      [XIP FOM APPS RO NORMAL]      
      [XIP FOM APP RO NORMAL]
   } >XIP_RO_MEMORY : XIP_SEGMENT
   
   /* RAM_FOM_APPS_CODE_SEGMENT */
   RAM_FOM_APPS_RO_REGION :
   {
      *(.conststring)
      *(.constdata)
      *(.rodata*)
      *(RAM_FOM_APPS_RO_SECTION)
      [RAM FOM APPS RO NORMAL]
      [RAM FOM APP RO NORMAL] 
   } >RAM_FOM_APPS_RO_MEMORY : RAM_FOM_APPS_CODE_SEGMENT

   /* RAM_FOM_BSP_CODE_SEGMENT */
   RAM_FOM_BSP_RO_REGION :
   {
      *(.text)

      /* Needed for C++ static constructors. See __initialize_cpp__aeabi_ */
      PROVIDE_HIDDEN(__init_array_begin = .);
      *(.init_array*)
      PROVIDE_HIDDEN(__init_array_end = .);
      [RAM FOM SYS RO NORMAL]
      *(RAM_FOM_BSP_RO_SECTION)
   } >RAM_FOM_BSP_RO_MEMORY : RAM_FOM_BSP_CODE_SEGMENT

   RAM_FOM_BSP_ZI_REGION :
   {
     [RAM FOM SYS ZI NORMAL]
      *(RAM_FOM_BSP_ZI_SECTION)
      
   } >RAM_FOM_BSP_DATA_MEMORY : RAM_FOM_BSP_DATA_SEGMENT

   RAM_FOM_BSP_RW_REGION :
   {
      [RAM FOM SYS RW NORMAL]
      *(RAM_FOM_BSP_RW_SECTION) 
   } >RAM_FOM_BSP_DATA_MEMORY : RAM_FOM_BSP_DATA_SEGMENT

   /* RAM_FOM_APPS_DATA_SEGMENT */

   RAM_FOM_APPS_RW_REGION :
   {
      *(RAM_FOM_APPS_RW_SECTION)
      [RAM FOM APPS RW NORMAL]
      [RAM FOM APP RW NORMAL]
      *(.data)
   } >RAM_FOM_APPS_DATA_MEMORY : RAM_FOM_APPS_DATA_SEGMENT
   
   RAM_FOM_APPS_ZI_REGION :
   {
      _RAM_FOM_APPS_ZI_START = .;
      *(COMMON)
      *(RAM_FOM_APPS_ZI_SECTION)
      [RAM FOM APPS ZI NORMAL]
      [RAM FOM APP ZI NORMAL]
      *(.bss)
      _RAM_FOM_APPS_ZI_END = ALIGN(0x100);      
   } >RAM_FOM_APPS_DATA_MEMORY : RAM_FOM_APPS_DATA_SEGMENT  
   .ARM.exidx :
   {
      *(.ARM.exidx*)
   } >XIP_RO_MEMORY : XIP_SEGMENT
}

/* Export symbols. */
Image$$RAM_SOM_BSP_ZI_REGION$$ZI$$Base        = _RAM_SOM_BSP_ZI_START;
Image$$RAM_SOM_BSP_ZI_REGION$$ZI$$Length      = _RAM_SOM_BSP_ZI_END - _RAM_SOM_BSP_ZI_START;

Image$$RAM_SBL_RO_REGION$$RW$$Base            = ORIGIN(RAM_SBL_RO_MEMORY);
Image$$RAM_SBL_RO_REGION$$RW$$Limit           = LENGTH(RAM_SBL_RO_MEMORY);

Image$$RAM_FOM_BSP_ZI_REGION$$ZI$$Base            = ORIGIN(RAM_FOM_BSP_DATA_MEMORY);
Image$$RAM_FOM_BSP_ZI_REGION$$ZI$$Length          = LENGTH(RAM_FOM_BSP_DATA_MEMORY);

Image$$SBL_LOG_META_INFO_RW_SECTION$$Base     = ORIGIN(SBL_LOG_META_INFO_RW_MEMORY);
Image$$SBL_LOG_BUF_RW_SECTION$$Base           = ORIGIN(SBL_LOG_BUF_RW_MEMORY);

Image$$RAM_SOM_BSP_HEAP_REGION$$ZI$$Base         = ORIGIN(RAM_SOM_BSP_HEAP_MEMORY);
Image$$RAM_SOM_BSP_HEAP_REGION$$ZI$$Length       = LENGTH(RAM_SOM_BSP_HEAP_MEMORY);

Image$$RAM_SOM_BSP_HEAP_ZI_REGION$$ZI$$Base      = ORIGIN(RAM_SOM_BSP_HEAP_MEMORY);
Image$$RAM_SOM_BSP_HEAP_ZI_REGION$$ZI$$Length    = LENGTH(RAM_SOM_BSP_HEAP_MEMORY);


Image$$RAM_SOM_APPS_ZI_REGION$$ZI$$Base          = _RAM_SOM_APPS_ZI_START;
Image$$RAM_SOM_APPS_ZI_REGION$$ZI$$Length        = _RAM_SOM_APPS_ZI_END - _RAM_SOM_APPS_ZI_START;

Image$$RAM_FOM_APPS_ZI_REGION$$ZI$$Base          = _RAM_FOM_APPS_ZI_START;
Image$$RAM_FOM_APPS_ZI_REGION$$ZI$$Length        = _RAM_FOM_APPS_ZI_END - _RAM_FOM_APPS_ZI_START;

Image$$RAM_AON_MOM_ZI_REGION$$ZI$$Base           = ORIGIN(RAM_AON_DATA_MEMORY);
Image$$RAM_AON_MOM_ZI_REGION$$ZI$$Length         = LENGTH(RAM_AON_DATA_MEMORY);

Load$$RAM_SOM_BSP_ZI_REGION$$ZI$$Base            = _RAM_SOM_BSP_ZI_START;
Load$$RAM_SOM_BSP_HEAP_ZI_REGION$$ZI$$Base       = ORIGIN(RAM_SOM_BSP_HEAP_MEMORY);
Load$$RAM_SOM_APPS_ZI_REGION$$ZI$$Base           = _RAM_SOM_APPS_ZI_START;
Load$$RAM_FOM_BSP_ZI_REGION$$ZI$$Base            = ORIGIN(RAM_FOM_BSP_DATA_MEMORY);
Load$$RAM_FOM_APPS_ZI_REGION$$ZI$$Base           = _RAM_FOM_APPS_ZI_START;

Image$$RAM_SOM_BSP_DIAG_BUF_REGION$$ZI$$Base     = ORIGIN(RAM_SOM_BSP_DIAG_BUF_MEMORY);
Image$$RAM_SOM_BSP_DIAG_BUF_REGION$$ZI$$Length   = LENGTH(RAM_SOM_BSP_DIAG_BUF_MEMORY);

Image$$RAM_SOM_BSP_STACK_REGION$$ZI$$Base        = ORIGIN(RAM_SOM_BSP_STACK_MEMORY);
Image$$RAM_SOM_BSP_STACK_REGION$$ZI$$Limit       = ORIGIN(RAM_SOM_BSP_STACK_MEMORY) + LENGTH(RAM_SOM_BSP_STACK_MEMORY);

/*FOM HEAP begins at the end of FOM_APP_DATA region that is used-up by the application, an increase
in data usage will decrease HEAP and vice-versa*/ 
RTOS_HEAP_SIZE	= 0xDC00;
Image$$RAM_FOM_BSP_RTOS_HEAP_REGION$$ZI$$Base	 = _RAM_FOM_APPS_ZI_END;	
Image$$RAM_FOM_BSP_HEAP_REGION$$ZI$$Base         = RTOS_HEAP_SIZE + Image$$RAM_FOM_BSP_RTOS_HEAP_REGION$$ZI$$Base;
Image$$RAM_FOM_BSP_STACK_REGION$$ZI$$Base        = ORIGIN(RAM_FOM_BSP_STACK_MEMORY);
Image$$RAM_FOM_BSP_STACK_REGION$$ZI$$Limit       = ORIGIN(RAM_FOM_BSP_STACK_MEMORY) + LENGTH(RAM_FOM_BSP_STACK_MEMORY);

/*Following symbols should be retained as undefined symbols*/
EXTERN(
qca_init 
gTsensBsp_devcfg_xml 
gAdcBsp_devcfg_xml 
quartz_ram_function_table 
wlan_secboot_auth 
mom_indirection_table 
som_indirection_table 
fom_indirection_table 
ram_function_table 
ram_function_table_som 
ram_function_table_mom
gTsensBsp_qca4020_devcfg_xml 
gAdcBsp_qca4020_devcfg_xml 
spi_first_port_qca4020_devcfg_xml 
I2CCoreConfig01_qca4020_devcfg_xml 
uart_first_port_qca4020_devcfg_xml 
gGPIOIntConfigTable_qca4020_devcfg_xml 
IPCIntConfig_qca4020_devcfg_xml 
InterruptControllerPriorityConfig_qca4020_devcfg_xml 
IPCIntIRQData_qca4020_devcfg_xml 
I2CCoreConfig02_qca4020_fom_xml  
spi_second_port_qca4020_fom_xml 
uart_second_port_qca4020_fom_xml 
platFlashPwrData_qca4020_fom_xml 
platThreadConfig_qca4020_fom_xml 
DALPROP_PropBin_qca4020_devcfg_xml 
DALPROP_StructPtrs_qca4020_devcfg_xml 
DALPROP_StructPtrs_qca4020_fom_xml 
DALPROP_PropBin_qca4020_fom_xml 
DALPROP_PropsInfo_qca4020_devcfg_xml 
DALPROP_PropsInfo_qca4020_fom_xml
gTsensBsp_qca4024_devcfg_xml 
gAdcBsp_qca4024_devcfg_xml 
spi_first_port_qca4024_devcfg_xml 
I2CCoreConfig01_qca4024_devcfg_xml 
uart_first_port_qca4024_devcfg_xml 
gGPIOIntConfigTable_qca4024_devcfg_xml 
IPCIntConfig_qca4024_devcfg_xml 
InterruptControllerPriorityConfig_qca4024_devcfg_xml 
IPCIntIRQData_qca4024_devcfg_xml 
I2CCoreConfig02_qca4024_fom_xml  
spi_second_port_qca4024_fom_xml 
uart_second_port_qca4024_fom_xml 
platFlashPwrData_qca4024_fom_xml 
platThreadConfig_qca4024_fom_xml 
DALPROP_PropBin_qca4024_devcfg_xml 
DALPROP_StructPtrs_qca4024_devcfg_xml 
DALPROP_StructPtrs_qca4024_fom_xml 
DALPROP_PropBin_qca4024_fom_xml 
DALPROP_PropsInfo_qca4024_devcfg_xml 
DALPROP_PropsInfo_qca4024_fom_xml
gTsensBsp_qca4025_devcfg_xml 
gAdcBsp_qca4025_devcfg_xml 
spi_first_port_qca4025_devcfg_xml 
I2CCoreConfig01_qca4025_devcfg_xml 
uart_first_port_qca4025_devcfg_xml 
gGPIOIntConfigTable_qca4025_devcfg_xml 
IPCIntConfig_qca4025_devcfg_xml 
InterruptControllerPriorityConfig_qca4025_devcfg_xml 
IPCIntIRQData_qca4025_devcfg_xml 
I2CCoreConfig02_qca4025_fom_xml  
spi_second_port_qca4025_fom_xml 
uart_second_port_qca4025_fom_xml 
platFlashPwrData_qca4025_fom_xml 
platThreadConfig_qca4025_fom_xml 
DALPROP_PropBin_qca4025_devcfg_xml 
DALPROP_StructPtrs_qca4025_devcfg_xml 
DALPROP_StructPtrs_qca4025_fom_xml 
DALPROP_PropBin_qca4025_fom_xml 
DALPROP_PropsInfo_qca4025_devcfg_xml 
DALPROP_PropsInfo_qca4025_fom_xml
)
