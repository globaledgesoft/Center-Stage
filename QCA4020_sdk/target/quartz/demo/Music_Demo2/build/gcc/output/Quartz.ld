
/* RAM_START  = 0x10000000; */
/* RAM_LENGTH = 0x000B8000; */
/* XIP_START  = 0x10100000; */
/* XIP_LENGTH = 0x00080000; */

MEMORY
{
 RAM_AON_PATCHROM_RO_MEMORY                        (W)  : ORIGIN = 0x10001600, LENGTH = 0x4c0
 RAM_AON_RO_MEMORY                                 (W)  : ORIGIN = 0x10001ac0, LENGTH = 0x140
 RAM_AON_ROM_PATCHTABLE_RW_MEMORY                  (W)  : ORIGIN = 0x10001c00, LENGTH = 0x180
 RAM_AON_DATA_MEMORY                               (W)  : ORIGIN = 0x10001dc0, LENGTH = 0x240

 RAM_SOM_BSP_ROM_PATCHTABLE_RW_MEMORY              (W)  : ORIGIN = 0x10002f00, LENGTH = 0xd00
 RAM_SOM_BSP_DATA_MEMORY                           (W)  : ORIGIN = 0x10003c00, LENGTH = 0x500
 RAM_SOM_BSP_ROM2RAM_INDIRECTION_TABLE_RW_MEMORY   (W)  : ORIGIN = 0x10004100, LENGTH = 0x40
 RAM_SOM_DEVCFG_DATA_RW_MEMORY                     (W)  : ORIGIN = 0x10004140, LENGTH = 0x7c0

 RAM_SOM_BSP_PATCHROM_RO_MEMORY                    (RX) : ORIGIN = 0x10004900, LENGTH = 0xe00
 RAM_BSP_VENEER_RO_MEMORY                          (RX) : ORIGIN = 0x10005700, LENGTH = 0x900
 RAM_SOM_BSP_RO_MEMORY                             (RX) : ORIGIN = 0x10006000, LENGTH = 0x1600

 RAM_SOM_BSP_DIAG_BUF_MEMORY                       (W)  : ORIGIN = 0x1000e400, LENGTH = 0x280
 RAM_SOM_BSP_HEAP_MEMORY                           (W)  : ORIGIN = 0x1000e680, LENGTH = 0x1200
 RAM_SOM_BSP_STACK_MEMORY                          (W)  : ORIGIN = 0x1000f880, LENGTH = 0x780

 RAM_SOM_APPS_RO_MEMORY                            (RX) : ORIGIN = 0x10007600, LENGTH = 0x5a00
 RAM_SOM_APPS_DATA_MEMORY                          (W)  : ORIGIN = 0x1000d000, LENGTH = 0x1400

 RAM_FOM_BSP_ROM_PATCHTABLE_RW_MEMORY              (W)  : ORIGIN = 0x10013400, LENGTH = 0x3400
 RAM_FOM_BSP_ROM2RAM_INDIRECTION_TABLE_RW_0_MEMORY (W)  : ORIGIN = 0x10016800, LENGTH = 0x200
 RAM_FOM_BSP_ROM2RAM_INDIRECTION_TABLE_RW_1_MEMORY (W)  : ORIGIN = 0x10016a00, LENGTH = 0x200
 RAM_FOM_DEVCFG_DATA_RW_MEMORY                     (W)  : ORIGIN = 0x1001d400, LENGTH = 0xc00
 RAM_FOM_BSP_DATA_MEMORY                           (W)  : ORIGIN = 0x10016c00, LENGTH = 0x6800
 RAM_FOM_BSP_STACK_MEMORY                          (W)  : ORIGIN = 0x100af800, LENGTH = 0x800

 RAM_SBL_RAMDUMP_MEMORY                            (W)  : ORIGIN = 0x1001e000, LENGTH = 0x2000

 RAM_FOM_BSP_PATCHROM_RO_MEMORY                    (RX) : ORIGIN = 0x10020000, LENGTH = 0x5000
 RAM_FOM_BSP_RO_MEMORY                             (RX) : ORIGIN = 0x10025000, LENGTH = 0x21000
 RAM_FOM_APPS_RO_MEMORY                            (RX) : ORIGIN = 0x10046000, LENGTH = 0x3a000
 RAM_FOM_APPS_DATA_MEMORY                          (W)  : ORIGIN = 0x10080000, LENGTH = 0x10000

 RAM_SBL_RO_MEMORY                                 (RX) : ORIGIN = 0x100a0000, LENGTH = 0x2000
 RAM_SBL_RW_MEMORY                                 (W)  : ORIGIN = 0x100a2000, LENGTH = 0x6000
 RAM_SBL_ZI_MEMORY                                 (W)  : ORIGIN = 0x100a8000, LENGTH = 0x2000
 SBL_LOG_META_INFO_RW_MEMORY                       (W)  : ORIGIN = 0x100aa000, LENGTH = 0x40
 SBL_LOG_BUF_RW_MEMORY                             (W)  : ORIGIN = 0x100aa040, LENGTH = 0x1000
 XIP_RO_MEMORY                                     (RX) : ORIGIN = 0x1000000, LENGTH = 0x180000
 RAM_DIAG_STRING_RO_MEMORY                         (W)  : ORIGIN = 0x40000000,LENGTH = 0x2000
}

PHDRS
{
   XIP_SEGMENT                         PT_LOAD;
   RAM_AON_PATCHABLE_RW_SEGMENT        PT_LOAD;
   RAM_AON_PATCHABLE_RO_SEGMENT        PT_LOAD;
   RAM_AON_RO_SEGMENT               PT_LOAD;
   RAM_AON_DATA_SEGMENT             PT_LOAD;
   RAM_SOM_PATCH_DATA_SEGMENT    PT_LOAD;
   RAM_SOM_BSP_CODE_SEGMENT      PT_LOAD;
   RAM_SOM_BSP_DATA_SEGMENT      PT_LOAD;
   RAM_SOM_PATCHROM_CODE_SEGMENT PT_LOAD;
   RAM_SOM_APPS_CODE_SEGMENT     PT_LOAD;
   RAM_SOM_APPS_DATA_SEGMENT     PT_LOAD;
   RAM_FOM_PATCH_DATA_SEGMENT    PT_LOAD;
   RAM_FOM_BSP_DATA_SEGMENT      PT_LOAD;
   RAM_FOM_BSP_CODE_SEGMENT      PT_LOAD;
   RAM_FOM_PATCHROM_CODE_SEGMENT PT_LOAD;
   RAM_BSP_VENEER_SEGMENT        PT_LOAD;
   RAM_FOM_APPS_CODE_SEGMENT     PT_LOAD;
   RAM_FOM_APPS_DATA_SEGMENT     PT_LOAD;
   RAM_SBL_RAMDUMP_SEGMENT       PT_LOAD;
   RAM_SBL_DATA_SEGMENT          PT_LOAD;
   RAM_SBL_CODE_SEGMENT          PT_LOAD;
   RAM_DIAG_STRING_SEGMENT       PT_LOAD;   
   EXIDX_SEGMENT                 0x70000001 FLAGS(4);
}

SECTIONS
{
   /* RAM_AON_CONFIG_SEGMENT */
    RAM_AON_PATCHABLE_RW_REGION :
   {
      *(RAM_AON_BSP_RW_SECTION)
      */mom_patch_table_ARNTRI_qcm.o(.data)
   } >RAM_AON_ROM_PATCHTABLE_RW_MEMORY : RAM_AON_PATCHABLE_RW_SEGMENT

   RAM_AON_PATCHABLE_RO_REGION :
   {
	  */patch.lib:patch_quadspi.o(.text)
	  */patch.lib:patch_clock_mom.o(.text)
	  */patch.lib:patch_quadspi_osal_qurt.o(.text)
	  */patch.lib:patch_flash_common.o(.text)
	  */patch.lib:patch_flash_common.o(.constdata)
	  */patch.lib:patch_flash_common.o(.conststring)
      *(RAM_AON_BSP_RO_SECTION)
   } >RAM_AON_PATCHROM_RO_MEMORY : RAM_AON_PATCHABLE_RO_SEGMENT

   RAM_AON_RO_REGION :
   {
      *(RAM_AON_BSP_RO_SECTION)
      */core.lib:wakeup_handler.o(.text)
      */core.lib:mom_aon.o(.emb_text)
      */core.lib:mom_aon.o(.text)
      */mom_lp_test.o(.text)
      */mom_lp_test.o(.text.mom_oem_wakeup_handler)
      */platform_oem_mom.o(.text)
      */platform_oem_mom.o(.text.mom_oem_init)
   } >RAM_AON_RO_MEMORY : RAM_AON_RO_SEGMENT

   RAM_AON_ROM2RAM_INDIRECTION_TABLE_RW_REGION :
   {
      *(RAM_AON_ROM2RAM_INDIRECTION_TABLE_RW_SECTION)
   } >RAM_AON_DATA_MEMORY : RAM_AON_DATA_SEGMENT

   RAM_AON_MOM_RW_REGION :
   {
      *(RAM_AON_MOM_RW_SECTION)
      */core.lib:platform_omt.o(.data)
      */mom_lp_test.o(.data)
      */platform_oem_mom.o(.data)
   } >RAM_AON_DATA_MEMORY : RAM_AON_DATA_SEGMENT

   /* RAM_AON_CONFIG_SEGMENT */
   RAM_AON_MOM_ZI_REGION :
   {
      *(RAM_AON_MOM_ZI_SECTION)
      */core.lib:wakeup_handler.o(.bss)
      */core.lib:wakeup_handler.o(COMMON)
      */core.lib:mom_aon.o(.bss)
      */core.lib:mom_aon.o(COMMON)
      */mom_lp_test.o(.bss)
      */mom_lp_test.o(COMMON)
      */platform_oem_mom.o(.bss)
      */platform_oem_mom.o(COMMON)
   } >RAM_AON_DATA_MEMORY : RAM_AON_DATA_SEGMENT

   /* RAM_SOM_PATCH_DATA_SEGMENT */
   RAM_SOM_BSP_ROM_PATCHTABLE_RW_REGION :
   {
      *(RAM_SOM_BSP_ROM_PATCHTABLE_RW_SECTION)
      */som_patch_table_ARNTRI_qcm.o(.data)
   } >RAM_SOM_BSP_ROM_PATCHTABLE_RW_MEMORY : RAM_SOM_PATCH_DATA_SEGMENT

   /* RAM_SOM_BSP_DATA_SEGMENT */
   VECTOR_TABLE_RW_REGION :
   {
      *(VECTOR_TABLE_RW_SECTION)
   } >RAM_SOM_BSP_DATA_MEMORY : RAM_SOM_BSP_DATA_SEGMENT

   RAM_SOM_BSP_ROM2RAM_INDIRECTION_TABLE_RW_REGION :
   {
      *(RAM_SOM_BSP_ROM2RAM_INDIRECTION_TABLE_RW_SECTION)
      */v2core.lib:ram_function_table_som.o(RAM_SOM_BSP_ROM2RAM_INDIRECTION_TABLE_RW_SECTION)
   } >RAM_SOM_BSP_ROM2RAM_INDIRECTION_TABLE_RW_MEMORY : RAM_SOM_BSP_DATA_SEGMENT

   RAM_SOM_BSP_RW_REGION :
   {
      *(RAM_SOM_BSP_RW_SECTION)
      */core.lib:InterruptController_Internal_m4.o(VECTOR_TABLE_RW_SECTION)
      */v2core.lib:ram_function_table_mom.o(RAM_AON_ROM2RAM_INDIRECTION_TABLE_RW_SECTION)
   } >RAM_SOM_BSP_DATA_MEMORY : RAM_SOM_BSP_DATA_SEGMENT

   RAM_SOM_BSP_ZI_REGION :
   {
      _RAM_SOM_BSP_ZI_START = .;
      *(.bss.RAM_SOM_BSP_ZI_SECTION)
      */core.lib:timer_log.o(.bss)
      */core.lib:timer_log.o(COMMON)
      */core.lib:qurt_interrupt.o(.bss)
      */core.lib:qurt_interrupt.o(COMMON)
      */core.lib:malloc_ram.o(.bss)
      */core.lib:malloc_ram.o(COMMON)
      */v2core.lib:platform_ramdump_entry.o(.bss)
      */v2core.lib:platform_ramdump_entry.o(COMMON)
	  */patch.lib:patch_standalone_solver.o(.bss)
	  */patch.lib:patch_standalone_solver.o(COMMON)
	  */patch.lib:patch_clock.o(.bss)
	  */patch.lib:patch_clock.o(COMMON)
      _RAM_SOM_BSP_ZI_END = .;      
   } >RAM_SOM_BSP_DATA_MEMORY : RAM_SOM_BSP_DATA_SEGMENT

   RAM_SOM_DEVCFG_DATA_RW_REGION :
   {
      *(RAM_SOM_DEVCFG_DATA_RW_SECTION)
      */devcfg_devcfg_data.o(.rodata)
      */devcfg_devcfg_data.o(.text)
      */core.lib:devcfg_devcfg_AdcBsp.o(.constdata)
      */core.lib:devcfg_devcfg_TsensBsp.o(.constdata)
      */DALConfig_devcfg.o(.text)
      */DALConfig_devcfg.o(.rodata)
      */devcfg_devcfg_data.o(.data)
      */core.lib:devcfg_devcfg_GPIOInt_Config.o(.data)
      */core.lib:devcfg_devcfg_IPCInt_Config.o(.data)
      */core.lib:devcfg_devcfg_InterruptController_Config.o(.data)
      */v2core.lib:devcfg_devcfg_cfg1.o(.data)
      */v2core.lib:devcfg_devcfg_spi1_config.o(.data)
      */DALConfig_devcfg.o(.data)
   } >RAM_SOM_DEVCFG_DATA_RW_MEMORY : RAM_SOM_BSP_DATA_SEGMENT

   RAM_SOM_BSP_HEAP_ZI_REGION :
   {
      *(RAM_SOM_BSP_HEAP_ZI_SECTION)
   } >RAM_SOM_BSP_HEAP_MEMORY : RAM_SOM_BSP_DATA_SEGMENT

   RAM_SOM_BSP_STACK_ZI_REGION :
   {
      *(.bss.RAM_SOM_BSP_STACK_ZI_SECTION)
   } >RAM_SOM_BSP_STACK_MEMORY : RAM_SOM_BSP_DATA_SEGMENT

   /* RAM_SOM_BSP_CODE_SEGMENT */
   RAM_SOM_BSP_RO_REGION :
   {
      *(RAM_SOM_BSP_RO_SECTION)
      */core.lib:qurt_power_shutdown_asm.o(qurt_power_shutdown)
      */core.lib:timer_log.o(.text)
      */core.lib:qurt_interrupt_ram_asm.o(IntCont)
      */core.lib:qurt_interrupt.o(.text)
      */core.lib:InterruptController_Internal_m4.o(.text)
      */core.lib:malloc_ram.o(.text)
      */core.lib:diag_ram.o(.text)
      */core.lib:som_init_internal.o(.emb_text)
      */core.lib:som_init_internal.o(.text)
      */core.lib:som_init_internal.o(.constdata)
      */core.lib:som_init_internal.o(.conststring)
      */core.lib:qapi_mom.o(.text)
      */core.lib:platform_ram_data.o(PLATFROM_AON_DATA)
      */core.lib:platform_ram_data_init.o(.text)
      */core.lib:platform_version.o(.text)
      */core.lib:diag_msg_ram.o(.text)
      */core.lib:diag_msg_ram.o(i.diag_available)
      */v2core.lib:qapi_diag_ram.o(.text)
      */v2core.lib:qapi_diag_ram.o(i.diag_available)
      */v2core.lib:ram_function_table_mom.o(.text)
      */v2core.lib:platform_ramdump_entry.o(.emb_text)
      */v2core.lib:platform_ramdump_entry.o(.text)
      */v2core.lib:platform_ramdump_entry.o(.constdata)
      */v2core.lib:platform_ramdump_entry.o(.conststring)
      */patch.lib:patch_spi_plat.o(.text)
      */patch.lib:patch_spi_sys.o(.text)
      */v2core.lib:ram_function_table_som.o(.text)
   } >RAM_SOM_BSP_RO_MEMORY : RAM_SOM_BSP_CODE_SEGMENT

   /* RAM_SOM_PATCHROM_CODE_SEGMENT */
   RAM_SOM_BSP_PATCHROM_RO_REGION :
   {
      *(RAM_SOM_BSP_PATCHROM_RO_SECTION)
      */patch.lib:patch_diag_rom.o(.text)
      */patch.lib:patch_HALtlmm.o(.text)
      */patch.lib:patch_uSleep_npa.o(.text)
      */patch.lib:patch_qapi_tlmm.o(.text)
      */patch.lib:patch_tlmm.o(.text)
      */patch.lib:patch_BSPusleep.o(.text)
      */patch.lib:AdcPatches.o(.text)
      */patch.lib:AdcPatches.o(i.diag_available)
      */patch.lib:patch_qapi_slp.o(.text)
      */patch.lib:patch_timer.o(.text)
      */patch.lib:patch_standalone_solver.o(.text)
      */patch.lib:patch_platform_util.o(.text)
      */patch.lib:patch_clock.o(.text)
   } >RAM_SOM_BSP_PATCHROM_RO_MEMORY : RAM_SOM_PATCHROM_CODE_SEGMENT

   /* RAM_BSP_VENEER_SEGMENT */
   RAM_BSP_VENEER_RO_REGION :
   {
      */core.lib:mom.o(.text)
      */core.lib:mom.o(.constdata)
      */core.lib:mom.o(.conststring)
   } >RAM_BSP_VENEER_RO_MEMORY : RAM_BSP_VENEER_SEGMENT

   /* RAM_SOM_APPS_CODE_SEGMENT */
   RAM_SOM_APPS_RO_REGION :
   {
      *(RAM_SOM_APPS_RO_SECTION)
      */core.lib:dsr_framework_test.o(.text)
      */core.lib:qurt_power_shutdown.o(.text)
      */core.lib:qurt_power_shutdown.o(.constdata)
      */core.lib:qurt_power_shutdown.o(.conststring)
      */som_lp_test.o(.text)
      */som_lp_test.o(.text.som_transition_test_cb)
      */som_lp_test.o(.text.som_dsr_default_handler)
      */som_lp_test.o(.text.som_test_gpio_isr)
      */som_lp_test.o(.text.som_dsr_gpio_handler)
      */som_lp_test.o(.text.som_timer1_cb)
      */som_lp_test.o(.text.som_timer2_cb)
      */som_lp_test.o(.text.spi_Tx_callback)
      */som_lp_test.o(.text.fom_test_gpio_isr)
      */som_lp_test.o(.text.som_set_wakeup_time)
      */som_lp_test.o(.text.som_configure_scheduled_wakeup)
      */som_lp_test.o(.text.som_app_init)
      */som_lp_test.o(.text.som_transition_test)
      */som_lp_test.o(.text.som_app_exit)
      */som_lp_test.o(.text.som_app_entry_internal)
      */som_lp_test.o(.rodata)
      */som_lp_test.o(.rodata.str1.4)
      */platform_oem_som.o(.text)
      */platform_oem_som.o(.text.som_app_entry)
   } >RAM_SOM_APPS_RO_MEMORY : RAM_SOM_APPS_CODE_SEGMENT

   /* RAM_SOM_APPS_DATA_SEGMENT */
   RAM_SOM_APPS_RW_REGION :
   {
     *(RAM_SOM_APPS_RW_SECTION)
     */core.lib:dsr_framework_test.o(.data)
     */som_lp_test.o(.data)
     */platform_oem_som.o(.data)
   } >RAM_SOM_APPS_DATA_MEMORY : RAM_SOM_APPS_DATA_SEGMENT

   RAM_SOM_APPS_ZI_REGION :
   {
     _RAM_SOM_APPS_ZI_START = .;
     *(RAM_SOM_APPS_ZI_SECTION)
     */core.lib:dsr_framework_test.o(.bss)
     */core.lib:dsr_framework_test.o(COMMON)
     */som_lp_test.o(.bss)
     */som_lp_test.o(COMMON)
     */platform_oem_som.o(.bss)
     */platform_oem_som.o(COMMON)
     _RAM_SOM_APPS_ZI_END = .;     
   } >RAM_SOM_APPS_DATA_MEMORY : RAM_SOM_APPS_DATA_SEGMENT

   /* RAM_FOM_PATCH_DATA_SEGMENT */
   RAM_FOM_BSP_ROM_PATCHTABLE_RW_REGION :
   {
      *(RAM_FOM_BSP_ROM_PATCHTABLE_RW_SECTION)
      */fom_patch_table_ARNTRI_qcm.o(.data)
   } >RAM_FOM_BSP_ROM_PATCHTABLE_RW_MEMORY : RAM_FOM_PATCH_DATA_SEGMENT

   /* RAM_FOM_BSP_DATA_SEGMENT */
   RAM_FOM_BSP_ROM2RAM_INDIRECTION_TABLE_RW_REGION_0 :
   {
      *(RAM_FOM_BSP_ROM2RAM_INDIRECTION_TABLE_RW_SECTION_0)
   } >RAM_FOM_BSP_ROM2RAM_INDIRECTION_TABLE_RW_0_MEMORY : RAM_FOM_BSP_DATA_SEGMENT

   RAM_FOM_BSP_ROM2RAM_INDIRECTION_TABLE_RW_REGION_1 :
   {
      *(RAM_FOM_BSP_ROM2RAM_INDIRECTION_TABLE_RW_SECTION_1)
   } >RAM_FOM_BSP_ROM2RAM_INDIRECTION_TABLE_RW_1_MEMORY : RAM_FOM_BSP_DATA_SEGMENT

   RAM_FOM_DEVCFG_DATA_RW_REGION :
   {
     *(RAM_FOM_DEVCFG_DATA_RW_SECTION)
     */devcfg_fom_data.o(.rodata)
     */devcfg_fom_data.o(.text)
     */core.lib:fom_devcfg_platform_props.o(.constdata)
     */v2core.lib:fom_devcfg_uart_quartz_config.o(.constdata)
     */DALConfig_fom.o(.text)
     */DALConfig_fom.o(.rodata)
     */devcfg_fom_data.o(.data)
     */core.lib:fom_devcfg_platform_props.o(.data)
     */v2core.lib:fom_devcfg_spi2_config.o(.data)
     */v2core.lib:fom_devcfg_cfg2.o(.data)
     */v2core.lib:fom_devcfg_uart_quartz_config.o(.data)
     */DALConfig_fom.o(.data)
   } >RAM_FOM_DEVCFG_DATA_RW_MEMORY : RAM_FOM_BSP_DATA_SEGMENT

   /* RAM_FOM_BSP_STACK_SEGMENT */
   RAM_FOM_BSP_STACK_ZI_REGION :
   {
   } >RAM_FOM_BSP_STACK_MEMORY : RAM_FOM_BSP_STACK_SEGMENT

   /* RAM_FOM_PATCHROM_CODE_SEGMENT */
   RAM_FOM_BSP_PATCHROM_RO_REGION :
   {
     */patch.lib:patch_CeML.o(.text)
     */patch.lib:patch_v2_platcfg_mgr.o(.text)
     */patch.lib:patch_CeCL_Clk.o(.text)
     */patch.lib:sdio_patch.o(.text)
     */patch.lib:patch_M4_QIPC.o(.text)
   } >RAM_FOM_BSP_PATCHROM_RO_MEMORY : RAM_FOM_PATCHROM_CODE_SEGMENT

   /* RAM_SBL_RAMDUMP_SEGMENT */
   RAM_SBL_RAMDUMP_RW_REGION :
   {
      *(RAM_SBL_RAMDUMP_RW_SECTION)
      */core.lib:boot_sahara.o(.data)
      */core.lib:boot_sahara_impl.o(.bss.RAMDUMP_USB_BUFFER)
      */core.lib:qfprom_test.o(.data)
   } >RAM_SBL_RAMDUMP_MEMORY : RAM_SBL_RAMDUMP_SEGMENT

   RAM_SBL_RAMDUMP_ZI_REGION :
   {
      *(RAM_SBL_RAMDUMP_ZI_SECTION)
      */core.lib:usb_sbl_mem_util.o(.bss)
      */core.lib:usb_sbl_mem_util.o(COMMON)
      */core.lib:qusb_al_bulk.o(.bss)
      */core.lib:qusb_al_bulk.o(COMMON)
      */core.lib:boot_ramdump.o(.bss)
      */core.lib:boot_ramdump.o(COMMON)
      */core.lib:boot_sahara.o(.bss)
      */core.lib:boot_sahara.o(COMMON)
      */core.lib:boot_dload_debug.o(.bss)
      */core.lib:boot_dload_debug.o(COMMON)
      */core.lib:boot_sahara_impl.o(.bss)
      */core.lib:boot_sahara_impl.o(COMMON)
      */core.lib:qfprom.o(.bss)
      */core.lib:qfprom.o(COMMON)
      */core.lib:qfprom_target.o(.bss)
      */core.lib:qfprom_target.o(COMMON)
      */core.lib:qfprom_test.o(.bss)
      */core.lib:qfprom_test.o(COMMON)
   } >RAM_SBL_RAMDUMP_MEMORY : RAM_SBL_RAMDUMP_SEGMENT

   /* RAM_SBL_CODE_SEGMENT */
   RAM_SBL_RO_REGION :
   {
     *(RAM_SBL_RO_SECTION)
     */core.lib:sbl.o(SBL_VECTOR_TABLE)
     */core.lib:flash_init.o(.text)
     */core.lib:flash_init_config.o(.text)
     */core.lib:boot_logger.o(.text)
     */core.lib:boot_logger_ram.o(.text)
     */core.lib:boot_logger_ram.o(.conststring)
     */core.lib:boot_logger_timer.o(.text)
     */core.lib:sbl1_mc.o(.text)
     */core.lib:sbl1_mc.o(.conststring)
     */core.lib:sbl1_xip.o(.text)
     */core.lib:sbl1_xip.o(.constdata)
     */core.lib:sbl1_error_handler.o(.text)
     */core.lib:sbl1_error_handler.o(.conststring)
     */core.lib:sbl1_timer.o(.text)
     */core.lib:boot_mpu.o(.text)
     */core.lib:boot_mpu.o(.constdata)
     */core.lib:sbl1_hw_4020.o(.text)
     */core.lib:sbl.o(QUARTZ_SBL_ENTRY)
   } >RAM_SBL_RO_MEMORY : RAM_SBL_CODE_SEGMENT

   /* RAM_DIAG_STRING_SEGMENT */
   RAM_DIAG_STRING_RO_REGION :
   {
     *(.diagmsg.format)
   } >RAM_DIAG_STRING_RO_MEMORY : RAM_DIAG_STRING_SEGMENT
   
   /* RAM_SBL_DATA_SEGMENT */
   RAM_SBL_RW_REGION : SUBALIGN(4)
   {
      *(.bss.BOOT_HASH_SEGMENT)
      *(RAM_SBL_DATA_SEGMENT_RW_SECTION)
      */core.lib:flash_init_config.o(.data)
      */core.lib:boot_logger_ram.o(.data)
      */core.lib:sbl1_config.o(.data)
      */core.lib:sbl1_mc.o(.bss.BOOT_HASH_SEGMENT)
      */core.lib:sbl1_mc.o(.data)
      */core.lib:sbl1_error_handler.o(.bss.ERR_DATA)
      */core.lib:sbl1_error_handler.o(.data)
      */core.lib:boot_rollback_version_impl.o(.data)
   } >RAM_SBL_RW_MEMORY : RAM_SBL_DATA_SEGMENT

   RAM_SBL_ZI_REGION : SUBALIGN(4)
   {
      *(RAM_SBL_ZI_SECTION)
      */core.lib:boot_config.o(.bss)
      */core.lib:boot_config.o(COMMON)
      */core.lib:flash_init.o(.bss)
      */core.lib:flash_init.o(COMMON)
      */core.lib:boot_logger.o(.bss)
      */core.lib:boot_logger.o(COMMON)
      */core.lib:boot_logger_ram.o(.bss)
      */core.lib:boot_logger_ram.o(COMMON)
      */core.lib:sbl1_mc.o(.bss)
      */core.lib:sbl1_mc.o(COMMON)
      */core.lib:sbl1_error_handler.o(.bss)
      */core.lib:sbl1_error_handler.o(COMMON)
   } >RAM_SBL_ZI_MEMORY : RAM_SBL_DATA_SEGMENT

   SBL_LOG_META_INFO_RW_SECTION :
   {
   } >SBL_LOG_META_INFO_RW_MEMORY : RAM_SBL_DATA_SEGMENT

   SBL_LOG_BUF_RW_SECTION : SUBALIGN(4)
   {
   } >SBL_LOG_BUF_RW_MEMORY : RAM_SBL_DATA_SEGMENT

   /* XIP_SEGMENT */
   XIP_BSP_RO_REGION :
   {
      *(XIP_BSP_RO_SECTION)
      */core.lib:keypad.o(.text)
      */core.lib:qapi_kpd.o(.text)
      */core.lib:usb_compile_wrapper.o(.text)
      */core.lib:qusb_clock.o(.text)
      */core.lib:qusb_dcd_ch9.o(.text)
      */core.lib:qusb_dci.o(.text)
      */core.lib:qusb_dci.o(.constdata)
      */core.lib:qusb_dci.o(.conststring)
      */core.lib:qusb_dci_4020.o(.text)
      */core.lib:qusb_dci_4020.o(.constdata)
      */core.lib:qusb_dci_4020_hw_apis_sbl1.o(.text)
      */core.lib:qusb_log.o(.text)
      */core.lib:qusb_log.o(.constdata)
      */core.lib:qusb_log.o(.conststring)
      */core.lib:qusb_fd.o(.text)
      */core.lib:qusb_fd.o(.constdata)
      */core.lib:qusb_fd.o(.conststring)
      */core.lib:sdio_mbox.o(.text)
      */core.lib:sdio_mbox.o(.constdata)
      */core.lib:sdio_mbox.o(.conststring)
      */core.lib:platform_calibration.o(.text)
      */core.lib:platform_calibration.o(.constdata)
      */core.lib:platform_calibration.o(.conststring)
      */core.lib:qapi_htc_slave.o(.text)
      */core.lib:htc_slave.o(.text)
      */core.lib:htc_slave.o(.constdata)
      */core.lib:htc_slave.o(.conststring)
      */core.lib:qapi_fw_info.o(.text)
      */core.lib:diag_buffer_read.o(.text)
      */core.lib:diag_buffer_read.o(i.diag_available)
      */core.lib:diag.o(.text)
      */core.lib:diag.o(.constdata)
      */core.lib:diag.o(i.diag_available)
      */core.lib:diag_transport.o(.text)
      */core.lib:diag_transport_glink.o(.text)
      */core.lib:diag_transport_glink.o(.constdata)
      */core.lib:diag_transport_glink.o(i.diag_available)
      */core.lib:diag_transport_uart.o(.text)
      */core.lib:diag_transport_usb.o(.text)
      */core.lib:diag_transport_flash.o(.text)
      */core.lib:qapi_diag.o(.text)
      */core.lib:qapi_diag.o(i.diag_available)
      */core.lib:diag_cli.o(.text)
      */core.lib:diag_cli.o(.constdata)
      */core.lib:diag_cli.o(i.diag_available)
      */core.lib:diag_binary_log.o(.text)
      */core.lib:diag_binary_log.o(i.diag_available)
      */core.lib:diag_msg.o(.text)
      */core.lib:diag_msg.o(i.diag_available)
      */core.lib:diagpkt.o(.text)
      */core.lib:diagpkt.o(.constdata)
      */core.lib:diagpkt.o(i.diag_available)
      */core.lib:diagtools.o(.text)
      */core.lib:diagtools.o(.constdata)
      */core.lib:xport_quartz.o(.text)
      */core.lib:xport_quartz_config.o(.text)
      */core.lib:xport_quartz_config.o(.constdata)
      */core.lib:xport_quartz_config.o(.conststring)
      */core.lib:boot_timer.o(.text)
      */core.lib:boot_timer_impl.o(.text)
      */core.lib:glink_api.o(.text)
      */core.lib:glink_core_if.o(.text)
      */core.lib:glink_vector.o(.text)
      */core.lib:glink_core_internal.o(.text)
      */core.lib:glink_core_internal.o(.conststring)
      */core.lib:glink_core_intent.o(.text)
      */core.lib:glink_intent_core_setup.o(.text)
      */core.lib:glink_core_intent_xport.o(.text)
      */core.lib:apss_app.o(.text)
      */core.lib:apss_app.o(.constdata)
      */core.lib:apss_app.o(.conststring)
      */core.lib:fs.o(.text)
      */core.lib:fs_api.o(.text)
      */core.lib:fs_api.o(.constdata)
      */core.lib:fs_api.o(.conststring)
      */core.lib:fs_bdev.o(.text)
      */core.lib:fs_bdev.o(.constdata)
      */core.lib:fs_bdev.o(.conststring)
      */core.lib:fs_bdev_spinor.o(.text)
      */core.lib:fs_bdev_spinor.o(.constdata)
      */core.lib:fs_bdev_spinor.o(.conststring)
      */core.lib:fs_desc.o(.text)
      */core.lib:fs_desc.o(.constdata)
      */core.lib:fs_desc.o(.conststring)
      */core.lib:fs_ffs.o(.text)
      */core.lib:fs_ffs.o(.constdata)
      */core.lib:fs_ffs.o(.conststring)
      */core.lib:fs_ffs_buf.o(.text)
      */core.lib:fs_ffs_buf.o(.constdata)
      */core.lib:fs_ffs_buf.o(.conststring)
      */core.lib:fs_ffs_db.o(.text)
      */core.lib:fs_ffs_db.o(.constdata)
      */core.lib:fs_ffs_db.o(.conststring)
      */core.lib:fs_ffs_freemap.o(.text)
      */core.lib:fs_ffs_freemap.o(.constdata)
      */core.lib:fs_ffs_freemap.o(.conststring)
      */core.lib:fs_ffs_inode.o(.text)
      */core.lib:fs_ffs_inode.o(.constdata)
      */core.lib:fs_ffs_inode.o(.conststring)
      */core.lib:fs_ffs_iter.o(.text)
      */core.lib:fs_ffs_iter.o(.constdata)
      */core.lib:fs_ffs_iter.o(.conststring)
      */core.lib:fs_ffs_sb.o(.text)
      */core.lib:fs_ffs_sb.o(.constdata)
      */core.lib:fs_ffs_sb.o(.conststring)
      */core.lib:fs_global_lock.o(.text)
      */core.lib:fs_mount.o(.text)
      */core.lib:fs_mount.o(.constdata)
      */core.lib:fs_mount.o(.conststring)
      */core.lib:fs_namei.o(.text)
      */core.lib:fs_namei.o(.constdata)
      */core.lib:fs_namei.o(.conststring)
      */core.lib:fs_util.o(.text)
      */core.lib:fs_vnode.o(.text)
      */core.lib:fs_vnode.o(.constdata)
      */core.lib:fs_vnode.o(.conststring)
      */core.lib:fs_ftl.o(.text)
      */core.lib:fs_ftl.o(.constdata)
      */core.lib:fs_ftl.o(.conststring)
      */core.lib:fs_ftl_flash.o(.text)
      */core.lib:fs_ftl_flash.o(.constdata)
      */core.lib:fs_ftl_flash.o(.conststring)
      */core.lib:fs_osal.o(.text)
      */core.lib:fs_osal.o(.constdata)
      */core.lib:fs_osal.o(.conststring)
      */core.lib:fs_osal_heap.o(.text)
      */core.lib:fs_osal_heap.o(.constdata)
      */core.lib:fs_osal_heap.o(.conststring)
      */core.lib:qapi_fs.o(.text)
      */core.lib:fs_diag.o(.text)
      */core.lib:fs_diag.o(.constdata)
      */core.lib:fs_diag.o(.conststring)
      */core.lib:boot_loader.o(.text)
      */core.lib:boot_loader_impl.o(.text)
      */core.lib:boot_loader_xip.o(.text)
      */core.lib:boot_loader_xip.o(.constdata)
      */core.lib:boot_loader_m0.o(.text)
      */core.lib:glink_os_utils_qurt.o(.text)
      */core.lib:smem_list.o(.text)
      */quartzplatform.lib:quartz_ram_function_table.o(.text)
      */quartzplatform_xip.lib:qapi_rtc.o(.text)
      */quartzplatform_xip.lib:qapi_device_info.o(.text)
      */quartzplatform_xip.lib:qapi_heap_status.o(.text)
      */quartzplatform_xip.lib:qapi_reset.o(.text)
      */quartzplatform_xip.lib:cpu_debug_port.o(.text)
      */quartzplatform_xip.lib:qapi_delay.o(.text)
      */quartzplatform_xip.lib:device_info_port.o(.text)
      */quartzplatform_xip.lib:device_info_port_common.o(.text)
      */WLAN.lib:cust_api_ioctl.o(.text)
      */WLAN.lib:cust_api_ioctl.o(.constdata)
      */WLAN.lib:cust_api_ioctl.o(i.diag_available)
      */WLAN.lib:cust_hw_api_ext.o(.text)
      */WLAN.lib:cust_dset_nvram.o(.text)
      */WLAN.lib:cust_dset_nvram.o(.constdata)
      */WLAN.lib:cust_platform_api.o(.text)
      */WLAN.lib:cust_platform_api.o(.constdata)
      */WLAN.lib:cust_platform_api.o(.conststring)
      */WLAN.lib:cust_platform_api.o(i.diag_available)
      */WLAN.lib:cust_elf_loader.o(.text)
      */WLAN.lib:cust_elf_loader.o(.constdata)
      */WLAN.lib:wlan_secboot_sbl.o(.text)
      */WLAN.lib:cust_driver_suspend_resume.o(.text)
      */WLAN.lib:cust_driver_suspend_resume.o(.constdata)
      */WLAN.lib:cust_driver_suspend_resume.o(i.diag_available)
      */WLAN.lib:driver_suspend_resume.o(.text)
      */WLAN.lib:driver_suspend_resume.o(i.diag_available)
      */net.lib:nsport.o(.text)
      */net.lib:sl_cmn.o(.text)
      */net.lib:sl_cmn.o(.constdata)
      */net.lib:sl_cmn.o(i.diag_available)
      */net.lib:sl_v4.o(.text)
      */net.lib:sl_v4.o(.constdata)
      */net.lib:sl_v4.o(i.diag_available)
      */net.lib:sl_v6.o(.text)
      */net.lib:qapi_dhcpv4c.o(.text)
      */net.lib:qapi_dhcpv4s.o(.text)
      */net.lib:qapi_dhcpv6c.o(.text)
      */net.lib:qapi_dnsc.o(.text)
      */net.lib:qapi_dnsc.o(.constdata)
      */net.lib:qapi_dnsc.o(i.diag_available)
      */net.lib:qapi_dnss.o(.text)
      */net.lib:qapi_mdnss.o(.text)
      */net.lib:qapi_httpsvr.o(.text)
      */net.lib:qapi_httpc.o(.text)
      */net.lib:qapi_webs.o(.text)
      */net.lib:qapi_ns_gen_v4.o(.text)
      */net.lib:qapi_ns_gen_v6.o(.text)
      */net.lib:qapi_ns_utils.o(.text)
      */net.lib:qapi_wlan_bridge.o(.text)
      */net.lib:qapi_sntpc.o(.text)
      */net.lib:qapi_mqttc.o(.text)
      */net.lib:qapi_socket.o(.text)
      */net.lib:qapi_ssl_cert.o(.text)
      */net.lib:qapi_csr_generator.o(.text)
      */net.lib:ns_mod.o(.text)
      */net.lib:ns_v4.o(.text)
      */net.lib:ns_v4.o(.constdata)
      */net.lib:ns_v4.o(i.diag_available)
      */net.lib:ns_bridge.o(.text)
      */net.lib:ns_utils.o(.text)
      */net.lib:ssl_cert_store.o(.text)
      */net.lib:ssl_cert_store.o(.constdata)
      */net.lib:ssl_cert_store.o(.conststring)
      */net.lib:shared_buffer.o(.text)
      */net.lib:cert_validation.o(.text)
      */net.lib:cert_validation.o(.constdata)
      */net.lib:strrcl_sntpclt.o(.text)
      */net.lib:strrcl_dnsc.o(.text)
      */net.lib:strrcl_dnss.o(.text)
      */net.lib:qapi_dnssd.o(.text)
      */net.lib:qapi_ssl_control.o(.text)
      */net.lib:qapi_base64.o(.text)
      */net.lib:qapi_ua.o(.text)
      */net.lib:qapi_websocket.o(.text)
      */net.lib:net_devcfg.o(.text)
      */net.lib:net_devcfg.o(.constdata)
      */net.lib:net_devcfg.o(i.diag_available)
      */net.lib:strrcl_iface.o(.text)
      */net.lib:strrcl_socket.o(.text)
      */net.lib:qapi_ns_suspend_resume.o(.text)
      */net.lib:usersetup.o(.text)
      */net.lib:ssl_control.o(.text)
      */net.lib:ssl_control.o(i.diag_available)
      */net.lib:ssl_store_common.o(.text)
      */dhcpv6c.lib:create_sockets.o(.text)
      */dhcpv6c.lib:dhcpv6_bld_msg.o(.text)
      */dhcpv6c.lib:dhcpv6_bld_send_msg.o(.text)
      */dhcpv6c.lib:dhcpv6_loop.o(.text)
      */dhcpv6c.lib:dhcpv6_mod.o(.text)
      */dhcpv6c.lib:dhcpv6_mod.o(.constdata)
      */dhcpv6c.lib:dhcpv6_mod.o(.conststring)
      */dhcpv6c.lib:dhcpv6_port.o(.text)
      */dhcpv6c.lib:dhcpv6_process_msg.o(.text)
      */dhcpv6c.lib:dhcpv6_utils.o(.text)
      */dhcpv6c.lib:dhcpv6_utils.o(.constdata)
      */dhcpv6c.lib:dhcpv6_utils.o(.conststring)
      */sntpc.lib:sntpclnt.o(.text)
      */dnssrvr.lib:dnssrvr.o(.text)
      */sharkssl.lib:SharkSslCon_hs.o(.text)
      */sharkssl.lib:SharkSslCon_hs.o(.constdata)
      */sharkssl.lib:SharkSslCon_hs.o(.conststring)
      */sharkssl.lib:SharkSslBigInt.o(.text)
      */sharkssl.lib:SharkSslBigInt.o(.constdata)
      */sharkssl.lib:SharkSslBigInt.o(.conststring)
      */sharkssl.lib:SharkSslPublic.o(.text)
      */sharkssl.lib:SharkSslPublic.o(.constdata)
      */sharkssl.lib:SharkSslPublic.o(.conststring)
      */sharkssl.lib:SharkSsl_ALPN.o(.text)
      */sharkssl.lib:SharkSsl_ALPN.o(.constdata)
      */sharkssl.lib:SharkSsl_ALPN.o(.conststring)
      */sharkssl.lib:SharkSslCon_DTLS_hs.o(.text)
      */sharkssl.lib:SharkSslCon_DTLS_hs.o(.constdata)
      */sharkssl.lib:SharkSslCon_DTLS_hs.o(.conststring)
      */sharkssl.lib:SharkSslCon_DTLS_cust_hs.o(.text)
      */sharkssl.lib:SharkSslCon_DTLS_cust_hs.o(.constdata)
      */sharkssl.lib:SharkSslCert_common.o(.text)
      */sharkssl.lib:SharkSslCert_common.o(.constdata)
      */sharkssl.lib:SharkSslCert_common.o(.conststring)
      */cryptolib.lib:srp.o(.text)
      */cryptolib.lib:srp_hw.o(.text)
      */cryptolib.lib:srp_hw.o(.constdata)
      */cryptolib.lib:cmac_hw.o(.text)
      */cryptolib.lib:ecjpake_hw.o(.text)
      */cryptolib.lib:ecjpake_hw.o(.constdata)
      */cryptolib.lib:ec_utils.o(.text)
      */cryptolib.lib:ec_curve.o(.text)
      */cryptolib.lib:ec_curve.o(.constdata)
      */cryptolib.lib:obj_import.o(.text)
      */cryptolib.lib:obj_import.o(.constdata)
      */cryptolib.lib:persistent_obj_mgmt.o(.text)
      */cryptolib.lib:persistent_obj_mgmt.o(i.diag_available)
      */cryptolib.lib:persistent_obj_ecc.o(.text)
      */cryptolib.lib:persistent_obj_ecc.o(.constdata)
      */cryptolib.lib:persistent_obj_rsa.o(.text)
      */cryptolib.lib:persistent_obj_rsa.o(.constdata)
      */cryptolib.lib:persistent_obj_store.o(.text)
      */cryptolib.lib:persistent_obj_store.o(.constdata)
      */cryptolib.lib:persistent_obj_store.o(.conststring)
      */cryptolib.lib:hmac_aes_control.o(.text)
      */httpsvr.lib:ce_http.o(.text)
      */httpsvr.lib:htauth.o(.text)
      */httpsvr.lib:htauth.o(.conststring)
      */httpsvr.lib:htutils.o(.text)
      */httpsvr.lib:htutils.o(.conststring)
      */httpsvr.lib:htmllib.o(.text)
      */httpsvr.lib:htpers.o(.text)
      */httpsvr.lib:http.o(.text)
      */httpsvr.lib:http_mod.o(.text)
      */httpsvr.lib:httpconn.o(.text)
      */httpsvr.lib:httpport.o(.text)
      */httpsvr.lib:wbs_mod.o(.text)
      */httpsvr.lib:wbscgi.o(.text)
      */httpsvr.lib:webserver.o(.text)
      */httpsvr.lib:webserver.o(.conststring)
      */httpc.lib:http_client.o(.text)
      */httpc.lib:http_client.o(.conststring)
      */httpc.lib:http_client_upgrade_module.o(.text)
      */mqttc.lib:mqttc.o(.text)
      */mqttc.lib:mqttc.o(.constdata)
      */mqttc.lib:MQTTConnectClient.o(.text)
      */mqttc.lib:MQTTConnectServer.o(.text)
      */mqttc.lib:MQTTDeserializePublish.o(.text)
      */mqttc.lib:MQTTFormat.o(.text)
      */mqttc.lib:MQTTFormat.o(.conststring)
      */mqttc.lib:mqtt_mod.o(.text)
      */mqttc.lib:MQTTPacket.o(.text)
      */mqttc.lib:MQTTSerializePublish.o(.text)
      */mqttc.lib:MQTTSubscribeClient.o(.text)
      */mqttc.lib:MQTTSubscribeServer.o(.text)
      */mqttc.lib:MQTTUnsubscribeClient.o(.text)
      */mqttc.lib:MQTTUnsubscribeServer.o(.text)
      */vfs.lib:vfsfiles.o(.text)
      */vfs.lib:vfsfiles.o(.conststring)
      */userpass.lib:userpass.o(.text)
      */i2s.lib:i2s_mbox.o(.text)
      */i2s.lib:i2s_sys.o(.text)
      */i2s.lib:qapi_i2s.o(.text)
      */i2s.lib:i2s.o(.text)
      */i2s.lib:i2s.o(.constdata)
      */i2s.lib:i2s_intr.o(.text)
      */i2s.lib:i2s_api.o(.text)
      */i2s.lib:qapi_pcm.o(.text)
      */i2s.lib:pcm_internal.o(.text)
      */i2s.lib:pcm_internal.o(.constdata)
      */nichestack.lib:mld.o(.text)
      */nichestack.lib:mld_cmn.o(.text)
      */master_sdcc.lib:qapi_master_sdcc.o(.text)
      */fwup.lib:qapi_firmware_upgrade.o(.text)
      */fwup_engine.lib:fw_upgrade.o(.text)
      */fwup_engine.lib:fw_upgrade.o(.constdata)
      */fwup_engine.lib:fw_upgrade.o(.conststring)
      */csr.lib:cert_stitching.o(.text)
      */csr.lib:cert_stitching.o(.constdata)
      */csr.lib:csr_generator.o(.text)
      */csr.lib:csr_generator.o(.constdata)
      */csr.lib:csr_generator_common.o(.text)
      */csr.lib:csr_generator_common.o(.constdata)
      */qapi_ed25519.lib:qapi_ed25519.o(.text)
      */qapi_ed25519.lib:qapi_crypto_persistent_obj.o(.text)
      */qapi_ed25519.lib:qapi_crypto_import.o(.text)
      */qapi_securefs.lib:qapi_securefs.o(.text)
      */pka_port.lib:pka_host.o(.text)
      */pka_port.lib:pka_host.o(.constdata)
      */fs_helper.lib:fs_helper_m4.o(.text)
      */quartz_crypto_qapi.lib:qapi_attestation.o(.text)
      */zigbee.lib:zigbee.blocking.o(.text)
      */zigbee.lib:zigbee.blocking.o(.constdata)
      */zigbee.lib:zigbee.o(.text)
      */zigbee.lib:zigbee.o(.conststring)
      */zigbee.lib:zigbee.persist.o(.text)
      */zigbee.lib:zigbee.persist.o(.constdata)
      */zigbee.lib:zigbee.persist.o(.conststring)
      */zigbee.lib:zigbee.security.o(.text)
      */zigbee.lib:zigbee.security.o(.constdata)
      */zigbee.lib:zigbee.testcase.o(.text)
      */zigbee.lib:zigbee.timer.o(.text)
      */zigbee.lib:zigbee.timer.o(.conststring)
      */zigbee.lib:zigbee_leave.o(.text)
      */zigbee.lib:zigbee_whitelist.o(.text)
      */zigbee.lib:zigbee.power.o(.text)
      */zigbee.lib:zb.aes.o(.text)
      */zigbee.lib:zb.aps.o(.text)
      */zigbee.lib:zb.apsde.ack.o(.text)
      */zigbee.lib:zb.apsde.o(.text)
      */zigbee.lib:zb.apsde.o(.constdata)
      */zigbee.lib:zb.apsde.o(.conststring)
      */zigbee.lib:zb.apsde.data.o(.text)
      */zigbee.lib:zb.apsde.filter.check.o(.text)
      */zigbee.lib:zb.apsde.filter.list.o(.text)
      */zigbee.lib:zb.apsde.frag.o(.text)
      */zigbee.lib:zb.apsde.interpan.o(.text)
      */zigbee.lib:zb.apsde.interpan.o(.constdata)
      */zigbee.lib:zb.apsme.bind.o(.text)
      */zigbee.lib:zb.apsme.bind.o(.constdata)
      */zigbee.lib:zb.apsme.o(.text)
      */zigbee.lib:zb.apsme.o(.constdata)
      */zigbee.lib:zb.apsme.cmd.o(.text)
      */zigbee.lib:zb.apsme.endpt.o(.text)
      */zigbee.lib:zb.apsme.groups.o(.text)
      */zigbee.lib:zb.apsme.groups.o(.constdata)
      */zigbee.lib:zb.apsme.ib.o(.text)
      */zigbee.lib:zb.bdb.o(.text)
      */zigbee.lib:zb.bdb.ib.o(.text)
      */zigbee.lib:zcl.extras.status.o(.text)
      */zigbee.lib:zcl.extras.status.o(.conststring)
      */zigbee.lib:zigbee.extras.aps.o(.text)
      */zigbee.lib:zigbee.extras.nwk.o(.text)
      */zigbee.lib:zigbee.extras.status.o(.text)
      */zigbee.lib:zigbee.extras.string.o(.text)
      */zigbee.lib:zigbee.extras.zdo.o(.text)
      */zigbee.lib:zb.nwk.o(.text)
      */zigbee.lib:zb.nwk.nlde.bcast.o(.text)
      */zigbee.lib:zb.nwk.nlde.o(.text)
      */zigbee.lib:zb.nwk.nlde.dataconf.o(.text)
      */zigbee.lib:zb.nwk.nlde.dataind.o(.text)
      */zigbee.lib:zb.nwk.nlde.dataind.o(.constdata)
      */zigbee.lib:zb.nwk.nlde.datareq.o(.text)
      */zigbee.lib:zb.nwk.nlde.datareq.o(.constdata)
      */zigbee.lib:zb.nwk.nlde.route.o(.text)
      */zigbee.lib:zb.nwk.nlde.route.o(.constdata)
      */zigbee.lib:zb.nwk.nlme.addr.o(.text)
      */zigbee.lib:zb.nwk.nlme.addr.o(.conststring)
      */zigbee.lib:zb.nwk.nlme.associate.o(.text)
      */zigbee.lib:zb.nwk.nlme.associate.o(.conststring)
      */zigbee.lib:zb.nwk.nlme.beacon.o(.text)
      */zigbee.lib:zb.nwk.nlme.blocking.o(.text)
      */zigbee.lib:zb.nwk.nlme.o(.text)
      */zigbee.lib:zb.nwk.nlme.o(.conststring)
      */zigbee.lib:zb.nwk.nlme.discover.o(.text)
      */zigbee.lib:zb.nwk.nlme.formation.o(.text)
      */zigbee.lib:zb.nwk.nlme.ifc.o(.text)
      */zigbee.lib:zb.nwk.nlme.joinpolicy.o(.text)
      */zigbee.lib:zb.nwk.nlme.joinpolicy.o(.conststring)
      */zigbee.lib:zb.nwk.nlme.leave.o(.text)
      */zigbee.lib:zb.nwk.nlme.leave.o(.conststring)
      */zigbee.lib:zb.nwk.nlme.nib.o(.text)
      */zigbee.lib:zb.nwk.nlme.nib.o(.constdata)
      */zigbee.lib:zb.nwk.nlme.nnt.o(.text)
      */zigbee.lib:zb.nwk.nlme.nnt.o(.constdata)
      */zigbee.lib:zb.nwk.nlme.nnt.directjoin.o(.text)
      */zigbee.lib:zb.nwk.nlme.nnt.keepalive.o(.text)
      */zigbee.lib:zb.nwk.nlme.nnt.linkpower.o(.text)
      */zigbee.lib:zb.nwk.nlme.nnt.linkstatus.o(.text)
      */zigbee.lib:zb.nwk.nlme.orphan.o(.text)
      */zigbee.lib:zb.nwk.nlme.orphan.o(.conststring)
      */zigbee.lib:zb.nwk.nlme.permitjoin.o(.text)
      */zigbee.lib:zb.nwk.nlme.rejoin.o(.text)
      */zigbee.lib:zb.nwk.nlme.rejoin.o(.constdata)
      */zigbee.lib:zb.nwk.nlme.rejoin.o(.conststring)
      */zigbee.lib:zb.nwk.nlme.reset.o(.text)
      */zigbee.lib:zb.nwk.nlme.reset.o(.constdata)
      */zigbee.lib:zb.nwk.nlme.reset.o(.conststring)
      */zigbee.lib:zb.nwk.nlme.route.o(.text)
      */zigbee.lib:zb.nwk.nlme.rrec.o(.text)
      */zigbee.lib:zb.nwk.nlme.rrec.o(.constdata)
      */zigbee.lib:zb.nwk.nlme.rrep.o(.text)
      */zigbee.lib:zb.nwk.nlme.rrep.o(.constdata)
      */zigbee.lib:zb.nwk.nlme.rreq.o(.text)
      */zigbee.lib:zb.nwk.nlme.rreq.o(.constdata)
      */zigbee.lib:zb.nwk.nlme.scan.o(.text)
      */zigbee.lib:zb.nwk.nlme.scan.o(.conststring)
      */zigbee.lib:zb.nwk.nlme.start.o(.text)
      */zigbee.lib:zb.nwk.nlme.start.o(.constdata)
      */zigbee.lib:zb.nwk.nlme.start.o(.conststring)
      */zigbee.lib:zb.nwk.nlme.status.o(.text)
      */zigbee.lib:zb.nwk.nlme.sync.o(.text)
      */zigbee.lib:zb.nwk.nlme.update.o(.text)
      */zigbee.lib:zb.startup.blocking.o(.text)
      */zigbee.lib:zb.startup.o(.text)
      */zigbee.lib:zb.startup.callbacks.o(.text)
      */zigbee.lib:zb.startup.callbacks.o(.constdata)
      */zigbee.lib:zb.startup.config.o(.text)
      */zigbee.lib:zb.startup.config.o(.conststring)
      */zigbee.lib:zb.startup.findbind.o(.text)
      */zigbee.lib:zb.startup.form.o(.text)
      */zigbee.lib:zb.startup.form.o(.constdata)
      */zigbee.lib:zb.startup.join.o(.text)
      */zigbee.lib:zb.startup.join.o(.constdata)
      */zigbee.lib:zb.startup.join.o(.conststring)
      */zigbee.lib:zb.startup.rejoin.o(.text)
      */zigbee.lib:zb_startup_tc_rejoin.o(.text)
      */zigbee.lib:zcl.o(.text)
      */zigbee.lib:zcl.o(.constdata)
      */zigbee.lib:zcl.o(.conststring)
      */zigbee.lib:zcl_attr.o(.text)
      */zigbee.lib:zcl_attr.o(.conststring)
      */zigbee.lib:zcl_attr_discover.o(.text)
      */zigbee.lib:zcl_attr_discover.o(.constdata)
      */zigbee.lib:zcl_attr_float.o(.text)
      */zigbee.lib:zcl_attr_integer.o(.text)
      */zigbee.lib:zcl_attr_integer.o(.conststring)
      */zigbee.lib:zcl_attr_read_req.o(.text)
      */zigbee.lib:zcl_attr_read_req.o(.constdata)
      */zigbee.lib:zcl_attr_report.o(.text)
      */zigbee.lib:zcl_attr_scene.o(.text)
      */zigbee.lib:zcl_attr_string.o(.text)
      */zigbee.lib:zcl_attr_struct.o(.text)
      */zigbee.lib:zcl_attr_struct.o(.conststring)
      */zigbee.lib:zcl_attr_write_req.o(.text)
      */zigbee.lib:zcl_attr_write_req.o(.constdata)
      */zigbee.lib:zcl_attr_write_req.o(.conststring)
      */zigbee.lib:zcl_blocking.o(.text)
      */zigbee.lib:zcl_blocking.o(.conststring)
      */zigbee.lib:zcl_cluster_persist.o(.text)
      */zigbee.lib:zcl_command_ind.o(.text)
      */zigbee.lib:zcl_command_ind.o(.conststring)
      */zigbee.lib:zcl_command_req.o(.text)
      */zigbee.lib:zcl_alarm_client.o(.text)
      */zigbee.lib:zcl_alarm_server.o(.text)
      */zigbee.lib:zcl_alarm_server.o(.constdata)
      */zigbee.lib:zcl_basic_client.o(.text)
      */zigbee.lib:zcl_basic_server.o(.text)
      */zigbee.lib:zcl_basic_server.o(.constdata)
      */zigbee.lib:zcl_color_client.o(.text)
      */zigbee.lib:zcl_color_server.o(.text)
      */zigbee.lib:zcl_color_server.o(.constdata)
      */zigbee.lib:zcl_device_temp_client.o(.text)
      */zigbee.lib:zcl_device_temp_server.o(.text)
      */zigbee.lib:zcl_device_temp_server.o(.constdata)
      */zigbee.lib:zcl_groups_client.o(.text)
      */zigbee.lib:zcl_groups_server.o(.text)
      */zigbee.lib:zcl_groups_server.o(.constdata)
      */zigbee.lib:zcl_identify_server.o(.text)
      */zigbee.lib:zcl_identify_server.o(.constdata)
      */zigbee.lib:zcl_level_client.o(.text)
      */zigbee.lib:zcl_level_server.o(.text)
      */zigbee.lib:zcl_level_server.o(.constdata)
      */zigbee.lib:zcl_onoff_client.o(.text)
      */zigbee.lib:zcl_onoff_server.o(.text)
      */zigbee.lib:zcl_onoff_server.o(.constdata)
      */zigbee.lib:zcl_ota_client.o(.text)
      */zigbee.lib:zcl_ota_client.o(.constdata)
      */zigbee.lib:zcl_ota_server.o(.text)
      */zigbee.lib:zcl_power_client.o(.text)
      */zigbee.lib:zcl_power_server.o(.text)
      */zigbee.lib:zcl_scenes_client.o(.text)
      */zigbee.lib:zcl_scenes_server.o(.text)
      */zigbee.lib:zcl_scenes_server.o(.constdata)
      */zigbee.lib:zcl_time_client.o(.text)
      */zigbee.lib:zcl_time_server.o(.text)
      */zigbee.lib:zcl_time_server.o(.constdata)
      */zigbee.lib:zcl_doorlock_client.o(.text)
      */zigbee.lib:zcl_doorlock_server.o(.text)
      */zigbee.lib:zcl_doorlock_server.o(.constdata)
      */zigbee.lib:zcl_window_client.o(.text)
      */zigbee.lib:zcl_window_server.o(.text)
      */zigbee.lib:zcl_window_server.o(.constdata)
      */zigbee.lib:zcl_therm_client.o(.text)
      */zigbee.lib:zcl_therm_server.o(.text)
      */zigbee.lib:zcl_therm_server.o(.constdata)
      */zigbee.lib:zcl_fan_client.o(.text)
      */zigbee.lib:zcl_fan_server.o(.text)
      */zigbee.lib:zcl_fan_server.o(.constdata)
      */zigbee.lib:zcl_temperature_server.o(.text)
      */zigbee.lib:zcl_temperature_server.o(.constdata)
      */zigbee.lib:zcl_occupancy_client.o(.text)
      */zigbee.lib:zcl_occupancy_server.o(.text)
      */zigbee.lib:zcl_occupancy_server.o(.constdata)
      */zigbee.lib:zcl_ballast_config_server.o(.text)
      */zigbee.lib:zcl_ballast_config_server.o(.constdata)
      */zigbee.lib:zcl_illum_meas_server.o(.text)
      */zigbee.lib:zcl_illum_meas_server.o(.constdata)
      */zigbee.lib:zcl_water_content_server.o(.text)
      */zigbee.lib:zcl_water_content_server.o(.constdata)
      */zigbee.lib:zcl_ias_zone_client.o(.text)
      */zigbee.lib:zcl_ias_zone_server.o(.text)
      */zigbee.lib:zcl_ias_zone_server.o(.constdata)
      */zigbee.lib:zcl_ias_ace_client.o(.text)
      */zigbee.lib:zcl_ias_ace_server.o(.text)
      */zigbee.lib:zcl_ias_wd_client.o(.text)
      */zigbee.lib:zcl_ias_wd_server.o(.text)
      */zigbee.lib:zcl_ias_wd_server.o(.constdata)
      */zigbee.lib:zcl_touchlink_client.o(.text)
      */zigbee.lib:zcl_touchlink_server.o(.text)
      */zigbee.lib:zcl_test_profile_ep.o(.text)
      */zigbee.lib:zcl_test_profile_ep.o(.constdata)
      */zigbee.lib:zcl_test_profile_ep.o(.conststring)
      */zigbee.lib:zb.zdo.activeep.o(.text)
      */zigbee.lib:zb.zdo.addr.o(.text)
      */zigbee.lib:zb.zdo.annce.o(.text)
      */zigbee.lib:zb.zdo.bind.o(.text)
      */zigbee.lib:zb.zdo.blocking.o(.text)
      */zigbee.lib:zb.zdo.blocking.o(.constdata)
      */zigbee.lib:zb.zdo.o(.text)
      */zigbee.lib:zb.zdo.o(.constdata)
      */zigbee.lib:zb.zdo.complexdesc.o(.text)
      */zigbee.lib:zb.zdo.endbind.o(.text)
      */zigbee.lib:zb.zdo.matchdesc.o(.text)
      */zigbee.lib:zb.zdo.mgmt.bind.o(.text)
      */zigbee.lib:zb.zdo.mgmt.ieeejoinlist.o(.text)
      */zigbee.lib:zb.zdo.mgmt.leave.o(.text)
      */zigbee.lib:zb.zdo.mgmt.lqi.o(.text)
      */zigbee.lib:zb.zdo.mgmt.nwk.enh.update.o(.text)
      */zigbee.lib:zb.zdo.mgmt.nwk.update.o(.text)
      */zigbee.lib:zb.zdo.mgmt.nwk.update.o(.constdata)
      */zigbee.lib:zb.zdo.mgmt.nwk.update.o(.conststring)
      */zigbee.lib:zb.zdo.mgmt.permitjoin.o(.text)
      */zigbee.lib:zb.zdo.mgmt.rtg.o(.text)
      */zigbee.lib:zb.zdo.nodedesc.o(.text)
      */zigbee.lib:zb.zdo.parent.o(.text)
      */zigbee.lib:zb.zdo.parent.o(.conststring)
      */zigbee.lib:zb.zdo.powerdesc.o(.text)
      */zigbee.lib:zb.zdo.simpledesc.o(.text)
      */zigbee.lib:zb.zdo.simpledesc.o(.conststring)
      */zigbee.lib:zb.zdo.systemserverdisc.o(.text)
      */zigbee.lib:zb.zdo.userdesc.o(.text)
      */zigbee.lib:zb.zdode.o(.text)
      */zigbee.lib:zb.zgp.o(.text)
      */zigbee.lib:zb.zgp.o(.constdata)
      */zigbee.lib:zb.zgp.data.o(.text)
      */zigbee.lib:zb.zgp.queue.o(.text)
      */zigbee.lib:zb.zgp.queue.o(.constdata)
      */zigbee.lib:zgp_proxybasic_client.o(.text)
      */zigbee.lib:zgp_proxybasic_client.o(.constdata)
      */zigbee.lib:ieee802154_crc.o(.text)
      */zigbee.lib:ieee802154_crc.o(.constdata)
      */zigbee.lib:ieee802154_hdr.o(.text)
      */zigbee.lib:ieee802154_ie.o(.text)
      */zigbee.lib:ieee802154_misc.o(.text)
      */zigbee.lib:ieee802154_rssi.o(.text)
      */quartz_zigbee.lib:zigbee_os_port.o(.text)
      */quartz_zigbee.lib:zigbee_sec_port.o(.text)
      */quartz_zigbee.lib:zigbee_mac_port.o(.text)
      */quartz_zigbee.lib:qapi_zb.o(.text)
      */quartz_zigbee.lib:qapi_zb.o(.constdata)
      */quartz_zigbee.lib:qapi_zb_power.o(.text)
      */quartz_zigbee.lib:qapi_zb_nwk.o(.text)
      */quartz_zigbee.lib:qapi_zb_aps.o(.text)
      */quartz_zigbee.lib:qapi_zb_zdp.o(.text)
      */quartz_zigbee.lib:qapi_zb_bdb.o(.text)
      */quartz_zigbee.lib:qapi_zb_zgp.o(.text)
      */quartz_zigbee.lib:qapi_zb_interpan.o(.text)
      */quartz_zigbee.lib:qapi_zb_whitelist.o(.text)
      */quartz_zigbee.lib:qapi_zb_tp2.o(.text)
      */quartz_zigbee.lib:qapi_zb_tp2.o(.constdata)
      */quartz_zigbee.lib:qapi_zb_cl.o(.text)
      */quartz_zigbee.lib:qapi_zb_cl.o(.constdata)
      */quartz_zigbee.lib:qapi_zb_cl_alarm.o(.text)
      */quartz_zigbee.lib:qapi_zb_cl_alarm.o(.constdata)
      */quartz_zigbee.lib:qapi_zb_cl_basic.o(.text)
      */quartz_zigbee.lib:qapi_zb_cl_basic.o(.constdata)
      */quartz_zigbee.lib:qapi_zb_cl_color_control.o(.text)
      */quartz_zigbee.lib:qapi_zb_cl_color_control.o(.constdata)
      */quartz_zigbee.lib:qapi_zb_cl_device_temp.o(.text)
      */quartz_zigbee.lib:qapi_zb_cl_device_temp.o(.constdata)
      */quartz_zigbee.lib:qapi_zb_cl_groups.o(.text)
      */quartz_zigbee.lib:qapi_zb_cl_groups.o(.constdata)
      */quartz_zigbee.lib:qapi_zb_cl_identify.o(.text)
      */quartz_zigbee.lib:qapi_zb_cl_identify.o(.constdata)
      */quartz_zigbee.lib:qapi_zb_cl_level_control.o(.text)
      */quartz_zigbee.lib:qapi_zb_cl_level_control.o(.constdata)
      */quartz_zigbee.lib:qapi_zb_cl_onoff.o(.text)
      */quartz_zigbee.lib:qapi_zb_cl_onoff.o(.constdata)
      */quartz_zigbee.lib:qapi_zb_cl_ota.o(.text)
      */quartz_zigbee.lib:qapi_zb_cl_ota.o(.constdata)
      */quartz_zigbee.lib:qapi_zb_cl_power_config.o(.text)
      */quartz_zigbee.lib:qapi_zb_cl_scenes.o(.text)
      */quartz_zigbee.lib:qapi_zb_cl_scenes.o(.constdata)
      */quartz_zigbee.lib:qapi_zb_cl_time.o(.text)
      */quartz_zigbee.lib:qapi_zb_cl_touchlink.o(.text)
      */quartz_zigbee.lib:qapi_zb_cl_touchlink.o(.constdata)
      */quartz_zigbee.lib:qapi_zb_cl_doorlock.o(.text)
      */quartz_zigbee.lib:qapi_zb_cl_doorlock.o(.constdata)
      */quartz_zigbee.lib:qapi_zb_cl_wincover.o(.text)
      */quartz_zigbee.lib:qapi_zb_cl_wincover.o(.constdata)
      */quartz_zigbee.lib:qapi_zb_cl_thermostat.o(.text)
      */quartz_zigbee.lib:qapi_zb_cl_thermostat.o(.constdata)
      */quartz_zigbee.lib:qapi_zb_cl_fan_control.o(.text)
      */quartz_zigbee.lib:qapi_zb_cl_fan_control.o(.constdata)
      */quartz_zigbee.lib:qapi_zb_cl_temp_measure.o(.text)
      */quartz_zigbee.lib:qapi_zb_cl_temp_measure.o(.constdata)
      */quartz_zigbee.lib:qapi_zb_cl_occupancy.o(.text)
      */quartz_zigbee.lib:qapi_zb_cl_occupancy.o(.constdata)
      */quartz_zigbee.lib:qapi_zb_cl_ias_zone.o(.text)
      */quartz_zigbee.lib:qapi_zb_cl_ias_zone.o(.constdata)
      */quartz_zigbee.lib:qapi_zb_cl_ias_ace.o(.text)
      */quartz_zigbee.lib:qapi_zb_cl_ias_ace.o(.constdata)
      */quartz_zigbee.lib:qapi_zb_cl_ias_wd.o(.text)
      */quartz_zigbee.lib:qapi_zb_cl_ias_wd.o(.constdata)
      */quartz_zigbee.lib:qapi_zb_cl_ballast.o(.text)
      */quartz_zigbee.lib:qapi_zb_cl_ballast.o(.constdata)
      */quartz_zigbee.lib:qapi_zb_cl_illuminance.o(.text)
      */quartz_zigbee.lib:qapi_zb_cl_illuminance.o(.constdata)
      */quartz_zigbee.lib:qapi_zb_cl_rel_humid.o(.text)
      */quartz_zigbee.lib:qapi_zb_cl_rel_humid.o(.constdata)
      */mdns.lib:mdns.o(.text)
      */mdns.lib:mdnsd.o(.text)
      */mdns.lib:mdnsd.o(.constdata)
      */BLUETOPIA_SERVICES.lib:GAP.o(.text)
      */BLUETOPIA_SERVICES.lib:AIOS.o(.text)
      */BLUETOPIA_SERVICES.lib:AIOS.o(.constdata)
      */BLUETOPIA_SERVICES.lib:ANCS.o(.text)
      */BLUETOPIA_SERVICES.lib:ANS.o(.text)
      */BLUETOPIA_SERVICES.lib:ANS.o(.constdata)
      */BLUETOPIA_SERVICES.lib:BAS.o(.text)
      */BLUETOPIA_SERVICES.lib:BAS.o(.constdata)
      */BLUETOPIA_SERVICES.lib:BCS.o(.text)
      */BLUETOPIA_SERVICES.lib:BCS.o(.constdata)
      */BLUETOPIA_SERVICES.lib:BLS.o(.text)
      */BLUETOPIA_SERVICES.lib:BLS.o(.constdata)
      */BLUETOPIA_SERVICES.lib:BMS.o(.text)
      */BLUETOPIA_SERVICES.lib:BMS.o(.constdata)
      */BLUETOPIA_SERVICES.lib:CGMS.o(.text)
      */BLUETOPIA_SERVICES.lib:CGMS.o(.constdata)
      */BLUETOPIA_SERVICES.lib:CPS.o(.text)
      */BLUETOPIA_SERVICES.lib:CPS.o(.constdata)
      */BLUETOPIA_SERVICES.lib:CSCS.o(.text)
      */BLUETOPIA_SERVICES.lib:CSCS.o(.constdata)
      */BLUETOPIA_SERVICES.lib:CTS.o(.text)
      */BLUETOPIA_SERVICES.lib:CTS.o(.constdata)
      */BLUETOPIA_SERVICES.lib:DIS.o(.text)
      */BLUETOPIA_SERVICES.lib:DIS.o(.constdata)
      */BLUETOPIA_SERVICES.lib:ESS.o(.text)
      */BLUETOPIA_SERVICES.lib:GAPS.o(.text)
      */BLUETOPIA_SERVICES.lib:GAPS.o(.constdata)
      */BLUETOPIA_SERVICES.lib:GLS.o(.text)
      */BLUETOPIA_SERVICES.lib:GLS.o(.constdata)
      */BLUETOPIA_SERVICES.lib:HIDS.o(.text)
      */BLUETOPIA_SERVICES.lib:HIDS.o(.constdata)
      */BLUETOPIA_SERVICES.lib:HPS.o(.text)
      */BLUETOPIA_SERVICES.lib:HPS.o(.constdata)
      */BLUETOPIA_SERVICES.lib:HRS.o(.text)
      */BLUETOPIA_SERVICES.lib:HRS.o(.constdata)
      */BLUETOPIA_SERVICES.lib:HTS.o(.text)
      */BLUETOPIA_SERVICES.lib:HTS.o(.constdata)
      */BLUETOPIA_SERVICES.lib:IAS.o(.text)
      */BLUETOPIA_SERVICES.lib:IAS.o(.constdata)
      */BLUETOPIA_SERVICES.lib:IPS.o(.text)
      */BLUETOPIA_SERVICES.lib:IPSP.o(.text)
      */BLUETOPIA_SERVICES.lib:IPSP.o(.constdata)
      */BLUETOPIA_SERVICES.lib:LLS.o(.text)
      */BLUETOPIA_SERVICES.lib:LLS.o(.constdata)
      */BLUETOPIA_SERVICES.lib:LNS.o(.text)
      */BLUETOPIA_SERVICES.lib:LNS.o(.constdata)
      */BLUETOPIA_SERVICES.lib:NDCS.o(.text)
      */BLUETOPIA_SERVICES.lib:NDCS.o(.constdata)
      */BLUETOPIA_SERVICES.lib:OTS.o(.text)
      */BLUETOPIA_SERVICES.lib:OTS.o(.constdata)
      */BLUETOPIA_SERVICES.lib:PASS.o(.text)
      */BLUETOPIA_SERVICES.lib:PASS.o(.constdata)
      */BLUETOPIA_SERVICES.lib:PLXS.o(.text)
      */BLUETOPIA_SERVICES.lib:PLXS.o(.constdata)
      */BLUETOPIA_SERVICES.lib:RSCS.o(.text)
      */BLUETOPIA_SERVICES.lib:RSCS.o(.constdata)
      */BLUETOPIA_SERVICES.lib:RTUS.o(.text)
      */BLUETOPIA_SERVICES.lib:RTUS.o(.constdata)
      */BLUETOPIA_SERVICES.lib:SCPS.o(.text)
      */BLUETOPIA_SERVICES.lib:SCPS.o(.constdata)
      */BLUETOPIA_SERVICES.lib:TPS.o(.text)
      */BLUETOPIA_SERVICES.lib:TPS.o(.constdata)
      */BLUETOPIA_SERVICES.lib:TRDS.o(.text)
      */BLUETOPIA_SERVICES.lib:TRDS.o(.constdata)
      */BLUETOPIA_SERVICES.lib:UDS.o(.text)
      */BLUETOPIA_SERVICES.lib:UDS.o(.constdata)
      */BLUETOPIA_SERVICES.lib:WSS.o(.text)
      */BLUETOPIA_SERVICES.lib:WSS.o(.constdata)
      */BLUETOPIA_QAPI_SERVICES.lib:qGAP.o(.text)
      */BLUETOPIA_QAPI_SERVICES.lib:_GAPLE.o(.text)
      */BLUETOPIA_QAPI_SERVICES.lib:_GAPLE.o(.constdata)
      */BLUETOPIA_QAPI_SERVICES.lib:BTPSIPv6.o(.text)
      */BLUETOPIA_QAPI_SERVICES.lib:SLoWP.o(.text)
      */BLUETOPIA_QAPI_SERVICES.lib:qGAPLE.o(.text)
      */BLUETOPIA_QAPI_SERVICES.lib:qBSC.o(.text)
      */BLUETOPIA_QAPI_SERVICES.lib:qAIOS.o(.text)
      */BLUETOPIA_QAPI_SERVICES.lib:qANCS.o(.text)
      */BLUETOPIA_QAPI_SERVICES.lib:qANS.o(.text)
      */BLUETOPIA_QAPI_SERVICES.lib:qBAS.o(.text)
      */BLUETOPIA_QAPI_SERVICES.lib:qBCS.o(.text)
      */BLUETOPIA_QAPI_SERVICES.lib:qBLS.o(.text)
      */BLUETOPIA_QAPI_SERVICES.lib:qBMS.o(.text)
      */BLUETOPIA_QAPI_SERVICES.lib:qCGMS.o(.text)
      */BLUETOPIA_QAPI_SERVICES.lib:qCPS.o(.text)
      */BLUETOPIA_QAPI_SERVICES.lib:qCSCS.o(.text)
      */BLUETOPIA_QAPI_SERVICES.lib:qCTS.o(.text)
      */BLUETOPIA_QAPI_SERVICES.lib:qDIS.o(.text)
      */BLUETOPIA_QAPI_SERVICES.lib:qESS.o(.text)
      */BLUETOPIA_QAPI_SERVICES.lib:qGAPS.o(.text)
      */BLUETOPIA_QAPI_SERVICES.lib:qGLS.o(.text)
      */BLUETOPIA_QAPI_SERVICES.lib:qHIDS.o(.text)
      */BLUETOPIA_QAPI_SERVICES.lib:qHPS.o(.text)
      */BLUETOPIA_QAPI_SERVICES.lib:qHRS.o(.text)
      */BLUETOPIA_QAPI_SERVICES.lib:qHTS.o(.text)
      */BLUETOPIA_QAPI_SERVICES.lib:qIAS.o(.text)
      */BLUETOPIA_QAPI_SERVICES.lib:qIPS.o(.text)
      */BLUETOPIA_QAPI_SERVICES.lib:qIPSP.o(.text)
      */BLUETOPIA_QAPI_SERVICES.lib:qLLS.o(.text)
      */BLUETOPIA_QAPI_SERVICES.lib:qLNS.o(.text)
      */BLUETOPIA_QAPI_SERVICES.lib:qNDCS.o(.text)
      */BLUETOPIA_QAPI_SERVICES.lib:qOTS.o(.text)
      */BLUETOPIA_QAPI_SERVICES.lib:qPASS.o(.text)
      */BLUETOPIA_QAPI_SERVICES.lib:qPLXS.o(.text)
      */BLUETOPIA_QAPI_SERVICES.lib:qRSCS.o(.text)
      */BLUETOPIA_QAPI_SERVICES.lib:qRTUS.o(.text)
      */BLUETOPIA_QAPI_SERVICES.lib:qSCPS.o(.text)
      */BLUETOPIA_QAPI_SERVICES.lib:qSLoWP.o(.text)
      */BLUETOPIA_QAPI_SERVICES.lib:qTPS.o(.text)
      */BLUETOPIA_QAPI_SERVICES.lib:qTRDS.o(.text)
      */BLUETOPIA_QAPI_SERVICES.lib:qUDS.o(.text)
      */BLUETOPIA_QAPI_SERVICES.lib:qWSS.o(.text)
      */dnssd.lib:dnssd.o(.text)
      */dnssd.lib:dnssd.o(.constdata)
      */otp_tlv.lib:otp_tlv_read.o(.text)
      */otp_tlv.lib:otp_tlv_read.o(.constdata)
      */otp_tlv.lib:otp_tlv_read.o(.conststring)
      */otp_tlv.lib:otp_tlv_status.o(.text)
      */otp_tlv.lib:otp_tlv_status.o(.constdata)
      */otp_tlv.lib:otp_tlv_status.o(.conststring)
      */otp_tlv.lib:otp_tlv_write.o(.text)
      */otp_tlv.lib:otp_tlv_write.o(.constdata)
      */otp_tlv.lib:otp_tlv_write.o(.conststring)
      */otp_tlv.lib:swintr_perf.o(.text)
      */otp_tlv.lib:swintr_perf.o(.constdata)
      */otp_tlv.lib:swintr_perf.o(.conststring)
      */otp_tlv.lib:swintr_setup.o(.text)
      */otp_tlv.lib:swintr_setup.o(.constdata)
      */otp_tlv.lib:swintr_setup.o(.conststring)
      */otp_tlv.lib:dbgcall.o(.text)
      */otp_tlv.lib:dbgcall.o(.constdata)
      */otp_tlv.lib:dbgcall.o(.conststring)
      */base64.lib:b64encoder.o(.text)
      */base64.lib:b64encoder.o(.constdata)
      */base64.lib:b64decoder.o(.text)
      */PERSIST_M4.lib:persist.o(.text)
      */json.lib:json.o(.text)
      */json.lib:json.o(.constdata)
      */json_qapi.lib:qapi_json.o(.text)
      */WLAN_QAPI.lib:qapi_wlan_base.o(.text)
      */WLAN_QAPI.lib:qapi_wlan_base.o(i.__ARM_common_memcpy4_5)
      */WLAN_QAPI.lib:qapi_wlan_p2p.o(.text)
      */WLAN_QAPI.lib:qapi_wlan_prof.o(.text)
      */WLAN_QAPI.lib:wlan_qapi_helper.o(.text)
      */WLAN_QAPI.lib:wlan_qapi_helper.o(.constdata)
      */WLAN_QAPI.lib:wlan_qapi_helper.o(i.diag_available)
      */WLAN_QAPI.lib:cust_qapi.o(.text)
      */CUST_IPSTACK_INICHE.lib:cust_ipstack_install.o(.text)
      */wlan_lib_common_xip.lib:wlan_lib_port.o(.text)
      */wlan_lib_common_xip.lib:wlan_lib_port.o(i.diag_available)
      */wlan_lib_common_xip.lib:wlan_lib_dbg.o(.text)
      */wlan_lib_common_xip.lib:wlan_lib_dbg.o(i.diag_available)
      */wlan_lib_common_xip.lib:wlan_lib_event.o(.text)
      */wlan_lib_common_xip.lib:wlan_lib_event.o(i.diag_available)
      */wlan_lib_common_xip.lib:wlan_lib_interfaces.o(.text)
      */wlan_lib_common_xip.lib:wlan_lib_interfaces.o(i.diag_available)
      */wlan_lib_common_xip.lib:wlan_lib_quartz.o(.text)
      */wlan_lib_common_xip.lib:wlan_lib_quartz.o(i.diag_available)
      */cust_wlan_lib.lib:cust_wlan_lib.o(.text)
      */tlv_transport.lib:tlv_transport.o(.text)
      */crypto_port.lib:crypto_devcfg.o(.text)
      */crypto_port.lib:crypto_devcfg.o(.constdata)
      */crypto_port.lib:crypto_devcfg.o(i.diag_available)
      */tee_master.lib:tee_master.o(.text)
      */dnsclient.lib:dnsclnt.o(.text)
      */dnsclient.lib:dnsclnt.o(.constdata)
      */dnsclient.lib:reshost.o(.text)
      */securefs.lib:securefs.o(.text)
      */securefs.lib:securefs_hmac.o(.text)
      */securefs.lib:securefs_cipher.o(.text)
      */securefs.lib:securefs_lock.o(.text)
      */securefs.lib:securefs_file.o(.text)
      */securefs.lib:securefs_util.o(.text)
      */securefs_port.lib:securefs_m4.o(.text)
      */v2core.lib:rfs_server.o(.text)
      */v2core.lib:rfs_server.o(.constdata)
      */v2core.lib:rfs_server.o(.conststring)
      */v2core.lib:rfs_server.o(i.diag_available)
      */v2core.lib:rfs_server_osal.o(.text)
      */v2core.lib:rfs_server_osal.o(i.diag_available)
      */v2core.lib:rfs_server_osal_qurt.o(.text)
      */v2core.lib:rfs_server_osal_qurt.o(.constdata)
      */v2core.lib:rfs_server_osal_qurt.o(.conststring)
      */v2core.lib:rfs_server_osal_qurt.o(i.diag_available)
      */v2core.lib:rfs_server_pkt.o(.text)
      */v2core.lib:rfs_server_pkt.o(.constdata)
      */v2core.lib:rfs_server_pkt.o(.conststring)
      */v2core.lib:rfs_server_pkt.o(i.diag_available)
      */EDLManager.lib:EDLManager.o(.text)
      */patch.lib:patch_cust_api_init.o(.text)
      */patch.lib:patch_app_ping.o(.text)
      */patch.lib:patch_store_recall.o(.text)
      */patch.lib:patch_store_recall.o(.constdata)
      */patch.lib:patch_cust_api_wmi_rx.o(.text)
      */patch.lib:patch_cust_api_wmi_rx.o(.constdata)
      */patch.lib:patch_cust_api_wmi_rx.o(i.diag_available)
      */patch.lib:patch_cust_dbglog.o(.text)
      */patch.lib:patch_cust_dbglog.o(.constdata)
      */patch.lib:patch_cust_dbglog.o(i.diag_available)
      */patch.lib:patch_BTPSKRNL.o(.text)
      */patch.lib:patch_api_ioctl.o(.text)
      */patch.lib:patch_api_ioctl.o(i.diag_available)
      */patch.lib:patch_ssl_cert.o(.text)
      */patch.lib:patch_timeouts.o(.text)
      */patch.lib:patch_qapi_coex.o(.text)
      */patch.lib:patch_api_wmi_rx.o(.text)
      */patch.lib:patch_api_wmi_rx.o(i.diag_available)
      */patch.lib:patch_ip6route.o(.text)
      */patch.lib:patch_ip6frags.o(.text)
      */patch.lib:patch_driver_main.o(.text)
      */patch.lib:patch_driver_main.o(.constdata)
      */patch.lib:patch_op_mgmt.o(.text)
      */patch.lib:patch_sdio_hcd.o(.text)
      */patch.lib:patch_sdio_hcd.o(i.diag_available)
      */patch.lib:patch_api_stack_offload.o(.text)
      */patch.lib:patch_api_stack_offload.o(i.diag_available)
      */patch.lib:patch_ip6.o(.text)
      */patch.lib:patch_HCITRANS.o(.text)
      */patch.lib:patch_icmp6.o(.text)
      */patch.lib:patch_htc.o(.text)
      */patch.lib:patch_htc.o(.constdata)
      */patch.lib:patch_cust_driver_main.o(.text)
      */patch.lib:patch_cust_driver_main.o(.constdata)
      */patch.lib:patch_wmi.o(.text)
      */patch.lib:patch_wmi.o(i.diag_available)
      */patch.lib:patch_HCI.o(.text)
      */patch.lib:patch_coex.o(.text)
      */patch.lib:patch_nd.o(.text)
      */patch.lib:patch_SharkSSL.o(.text)
      */patch.lib:patch_obj_mgmt.o(.text)
      */patch.lib:patch_ip6mc.o(.text)
      */patch.lib:patch_L2CAP.o(.text)
      */patch.lib:patch_driver_init.o(.text)
      */patch.lib:patch_driver_init.o(.constdata)
      */patch.lib:patch_tee_master.o(.text)
      */patch.lib:patch_iface.o(.text)
      */patch.lib:patch_nettick.o(.text)
      */patch.lib:patch_qapi_hmi.o(.text)
      */patch.lib:patch_ssl.o(.text)
      */core.lib:boot_config.o(.text)
      */core.lib:boot_config.o(.conststring)
      */core.lib:boot_rollback_version.o(.text)
      */core.lib:boot_rollback_version_impl.o(.text)
      */core.lib:usb_sbl_mem_util.o(.text)
      */core.lib:qusb_al_bulk.o(.text)
      */core.lib:qusb_al_bulk.o(.constdata)
      */core.lib:boot_ramdump.o(.text)
      */core.lib:boot_ramdump.o(.constdata)
      */core.lib:boot_sahara.o(.text)
      */core.lib:boot_dload_debug.o(.text)
      */core.lib:boot_dload_debug.o(.constdata)
      */core.lib:boot_dload_debug.o(.conststring)
      */core.lib:boot_sahara_impl.o(.text)
      */core.lib:boot_sahara_impl.o(.constdata)
      */core.lib:qfprom_fuse_region_4020.o(.constdata)
      */core.lib:HALqfprom.o(.text)
      */core.lib:qfprom.o(.text)
      */core.lib:qfprom_target.o(.text)
      */core.lib:qfprom_test.o(.text)
   } >XIP_RO_MEMORY : XIP_SEGMENT

   XIP_OEM_RO_REGION :
   {
      *(XIP_OEM_RO_SECTION)
      */core.lib:usb_client_loopback_diag.o(.text)
      */core.lib:usb_client_loopback_diag.o(.constdata)
      */core.lib:usb_client_loopback_diag.o(.conststring)
      */core.lib:usb_client_util.o(.text)
      */core.lib:usb_client_util.o(.constdata)
      */core.lib:usb_client_util.o(.conststring)
      */core.lib:usb_mem_util.o(.text)
      */core.lib:usb_mem_util.o(.constdata)
      */core.lib:usb_mem_util.o(.conststring)
      */core.lib:usb_mem_util.o(i.usb_mem_init)
      */core.lib:usb_mem_util.o(i.usb_free_all_mem)
      */core.lib:usb_os_util.o(.text)
      */core.lib:usb_os_util.o(.constdata)
      */core.lib:usb_os_util.o(.conststring)
      */core.lib:usb_al_hlos_bulk.o(.text)
      */core.lib:usb_al_hlos_bulk.o(.constdata)
      */core.lib:usb_al_hlos_bulk.o(.conststring)
      */core.lib:usb_wrapper_api.o(.text)
      */core.lib:usb_isr.o(.text)
      */core.lib:usb_isr.o(.constdata)
      */core.lib:usb_isr.o(.conststring)
      */core.lib:core_test_m4f.o(.text)
      */core.lib:core_test_m4f.o(.constdata)
      */core.lib:core_test_m4f.o(.conststring)
      */core.lib:core_test_m4f.o(i.diag_available)
      */core.lib:reboot_test.o(.text)
      */core.lib:reboot_test.o(.constdata)
      */core.lib:reboot_test.o(.conststring)
      */core.lib:reboot_test.o(i.diag_available)
      */spple_demo.o(.text)
      */spple_demo.o(.text.DisplayPairingInformation)
      */spple_demo.o(.text.DisplayAnalogCharacteristic)
      */spple_demo.o(.text.DisplayIOCapabilities)
      */spple_demo.o(.text.LEPassKeyResponse)
      */spple_demo.o(.text.EnableExtendedScan)
      */spple_demo.o(.text.SetExtendedScanParams)
      */spple_demo.o(.text.EnableExtendedAdvertising)
      */spple_demo.o(.text.EnableDisableNotificationsIndications)
      */spple_demo.o(.text.SetBatteryLevelPresentationFormat)
      */spple_demo.o(.text.SetLocalAppearance)
      */spple_demo.o(.text.LEQueryEncryption)
      */spple_demo.o(.text.GetRegisteredImages)
      */spple_demo.o(.text.SLoWP_EventCallback)
      */spple_demo.o(.text.SendACLData)
      */spple_demo.o(.text.GetGATTMTU)
      */spple_demo.o(.text.SelectRemoteDevice)
      */spple_demo.o(.text.UnPairRemoteDevice)
      */spple_demo.o(.text.CancelConnectLE)
      */spple_demo.o(.text.ConnectLEDevice)
      */spple_demo.o(.text.GetLocalAddress)
      */spple_demo.o(.text.LESetPasskey)
      */spple_demo.o(.text.SetPairabilityMode)
      */spple_demo.o(.text.StringToUnsignedInteger)
      */spple_demo.o(.text.SetAIOSAnalogInput)
      */spple_demo.o(.text.SetAIOSDigitalInput)
      */spple_demo.o(.text.DisplayDigitalCharacteristic.part.7)
      */spple_demo.o(.text.DisplayAIOSCharacteristicInfo)
      */spple_demo.o(.text.GetAIOSServerInstanceInfoPtr)
      */spple_demo.o(.text.SetBatteryLevel)
      */spple_demo.o(.text.DisplayUUID)
      */spple_demo.o(.text.AutomaticReadMode)
      */spple_demo.o(.text.DisplayRawModeData)
      */spple_demo.o(.text.Loopback)
      */spple_demo.o(.text.ConfigureAdvReportDisplay)
      */spple_demo.o(.text.SetConnectionParameters)
      */spple_demo.o(.text.GetConnectionParameters)
      */spple_demo.o(.text.SetAdvertisingParameters)
      */spple_demo.o(.text.GetAdvertisingParameters)
      */spple_demo.o(.text.SetScanParameters)
      */spple_demo.o(.text.GetScanParameters)
      */spple_demo.o(.text.StoreDescriptorHandles.isra.24)
      */spple_demo.o(.text.ChangePairingParameters)
      */spple_demo.o(.text.SetConnectabilityMode)
      */spple_demo.o(.text.SetDiscoverabilityMode)
      */spple_demo.o(.text.ConfigureCapabilities.part.28)
      */spple_demo.o(.text.unlikely.SlavePairingRequestResponse)
      */spple_demo.o(.text.SendPairingRequest)
      */spple_demo.o(.text.DisconnectLE)
      */spple_demo.o(.text.RemoveDataFromBuffer.part.30)
      */spple_demo.o(.text.AddDataToBuffer.part.31)
      */spple_demo.o(.text.PairLE)
      */spple_demo.o(.text.SetExtendedAdvertisingParams)
      */spple_demo.o(.text.SetPHY)
      */spple_demo.o(.text.DisplayRemoteDevices)
      */spple_demo.o(.text.UnregisterAIOS)
      */spple_demo.o(.text.RegisterAIOS)
      */spple_demo.o(.text.UnregisterBAS)
      */spple_demo.o(.text.RegisterBAS)
      */spple_demo.o(.text.SetLocalName)
      */spple_demo.o(.text.ReadLocalName)
      */spple_demo.o(.text.UnregisterHIDS)
      */spple_demo.o(.text.RegisterHIDS)
      */spple_demo.o(.text.UnregisterImage)
      */spple_demo.o(.text.RegisterImage)
      */spple_demo.o(.text.UnregisterOTA)
      */spple_demo.o(.text.RegisterOTA)
      */spple_demo.o(.text.OTA_EventCallback)
      */spple_demo.o(.text.GetSLoWPConnectionMode)
      */spple_demo.o(.text.SetSLoWPConnectionMode)
      */spple_demo.o(.text.DisconnectSLoWPRouter)
      */spple_demo.o(.text.UnregisterSLoWPNode)
      */spple_demo.o(.text.RegisterSLoWPNode)
      */spple_demo.o(.text.UnregisterSCPS)
      */spple_demo.o(.text.RegisterSCPS)
      */spple_demo.o(.text.SendCredits.part.93)
      */spple_demo.o(.text.SendData.part.97)
      */spple_demo.o(.text.ACLDataCallback)
      */spple_demo.o(.text.StopTXRXTest)
      */spple_demo.o(.text.UnregisterSPPLE)
      */spple_demo.o(.text.RegisterSPPLE)
      */spple_demo.o(.text.EventCallback)
      */spple_demo.o(.text.LowPowerTransmitOverride)
      */spple_demo.o(.text.QueryLocalOOBData)
      */spple_demo.o(.text.DeletePersistentData)
      */spple_demo.o(.text.StorePersistentData)
      */spple_demo.o(.text.SetDataLength)
      */spple_demo.o(.text.Period_Tx_Callback)
      */spple_demo.o(.text.SetGATTMTU)
      */spple_demo.o(.text.StopScan)
      */spple_demo.o(.text.ScanLE)
      */spple_demo.o(.text.QueryTxPowerLevel)
      */spple_demo.o(.text.SetBLERadio)
      */spple_demo.o(.text.GetVersion)
      */spple_demo.o(.text.SetOTPAddress)
      */spple_demo.o(.text.EnableBBIF)
      */spple_demo.o(.text.ReadPHY)
      */spple_demo.o(.text.DisplayThroughput.part.36)
      */spple_demo.o(.text.ReadData.part.94.constprop.142)
      */spple_demo.o(.text.DataIndicationEvent)
      */spple_demo.o(.text.FillBufferWithString.part.32.constprop.143)
      */spple_demo.o(.text.SendProcess)
      */spple_demo.o(.text.ReceiveCreditEvent.part.100)
      */spple_demo.o(.text.StringToBinaryBlob.constprop.146)
      */spple_demo.o(.text.SetRemoteOOOBData)
      */spple_demo.o(.text.CreateNewDeviceInfoEntry.constprop.148)
      */spple_demo.o(.text.FreeDeviceInfoList.constprop.149)
      */spple_demo.o(.text.CloseStack)
      */spple_demo.o(.text.ShutdownBluetooth)
      */spple_demo.o(.text.LoadPersistentData)
      */spple_demo.o(.text.InitializeBluetooth)
      */spple_demo.o(.text.SearchDeviceInfoEntryByBD_ADDR.constprop.151)
      */spple_demo.o(.text.GATT_MSCD_Service_Discovery_Event_Callback)
      */spple_demo.o(.text.GATT_Connection_Event_Callback)
      */spple_demo.o(.text.DiscoverServices)
      */spple_demo.o(.text.GATT_ServerEventCallback_SPPLE)
      */spple_demo.o(.text.GATT_ClientEventCallback_SPPLE)
      */spple_demo.o(.text.SendDataCommand)
      */spple_demo.o(.text.ConfigureSPPLE)
      */spple_demo.o(.text.ReadDataCommand)
      */spple_demo.o(.text.SCPS_EventCallback)
      */spple_demo.o(.text.SetScanIntervalWindow)
      */spple_demo.o(.text.NotifyScanRefresh)
      */spple_demo.o(.text.ConnectSLoWPNode)
      */spple_demo.o(.text.HIDS_Event_Callback)
      */spple_demo.o(.text.GATT_ClientEventCallback_HIDS)
      */spple_demo.o(.text.SetSuspend)
      */spple_demo.o(.text.SetReport)
      */spple_demo.o(.text.SetProtocolMode)
      */spple_demo.o(.text.ConfigureHIDS)
      */spple_demo.o(.text.ReadHIDSConfiguration)
      */spple_demo.o(.text.SendReport)
      */spple_demo.o(.text.SendKeyString)
      */spple_demo.o(.text.GATT_ClientEventCallback_GAPS)
      */spple_demo.o(.text.BAS_EventCallback)
      */spple_demo.o(.text.NotifyBatteryLevel)
      */spple_demo.o(.text.GATT_ClientEventCallback_BAS)
      */spple_demo.o(.text.GetBatteryLevelPresentationFormat)
      */spple_demo.o(.text.AIOS_EventCallback)
      */spple_demo.o(.text.GetReport)
      */spple_demo.o(.text.ReadRemoteName)
      */spple_demo.o(.text.ReadRemoteAppearance)
      */spple_demo.o(.text.GetBatteryLevel)
      */spple_demo.o(.text.ReadAIOSCharacteristic)
      */spple_demo.o(.text.ReadAIOSPresentationFormat)
      */spple_demo.o(.text.ReadAIOSNumberOfDigitals)
      */spple_demo.o(.text.ConfigureRemoteSCPS)
      */spple_demo.o(.text.ConfigureRemoteHRS)
      */spple_demo.o(.text.ConfigureRemoteBAS)
      */spple_demo.o(.text.ConfigureRemoteAIOS)
      */spple_demo.o(.text.WriteAIOSDigitalOutput)
      */spple_demo.o(.text.WriteAIOSAnalogOutput)
      */spple_demo.o(.text.NotifyAIOSCharacteristic)
      */spple_demo.o(.text.SetThroughputMode)
      */spple_demo.o(.text.GATT_ClientEventCallback_SCPS)
      */spple_demo.o(.text.GATT_ClientEventCallback_HRS)
      */spple_demo.o(.text.GATT_Service_Discovery_Event_Callback)
      */spple_demo.o(.text.ReadLocalAppearance)
      */spple_demo.o(.text.GATT_ClientEventCallback_AIOS)
      */spple_demo.o(.text.BT_Stk_Id)
      */spple_demo.o(.text.mscd_InitializeBluetooth)
      */spple_demo.o(.text.mscd_select_device_for_connection)
      */spple_demo.o(.text.MSCDGetDeviceInfo)
      */spple_demo.o(.text.mscd_get_write_char_handle)
      */spple_demo.o(.text.GetLocalNameInAD)
      */spple_demo.o(.text.mscd_reset_device_data)
      */spple_demo.o(.text.mscd_write_motion_data)
      */spple_demo.o(.text.ResetMSCDSelectedDeviceData)
      */spple_demo.o(.text.mscd_add_temp_device)
      */spple_demo.o(.text.mscd_match_temp_device)
      */spple_demo.o(.text.mscd_filter_device)
      */spple_demo.o(.text.GAP_LE_Event_Callback.part.126)
      */spple_demo.o(.text.GAP_LE_Event_Callback)
      */spple_demo.o(.text.mscd_add_device)
      */spple_demo.o(.text.mscd_clear_remp_scan_data)
      */spple_demo.o(.text.BSC_Timer_Callback)
      */spple_demo.o(.text.mscd_match_device)
      */spple_demo.o(.text.mscd_handle_disconnection)
      */spple_demo.o(.text.mscd_add_scan_entry)
      */spple_demo.o(.text.mscd_assign_connection_info)
      */spple_demo.o(.text.mscd_discover_services)
      */spple_demo.o(.text.mscd_start_connect)
      */spple_demo.o(.text.mscd_any_device_tobe_scanned)
      */spple_demo.o(.text.mscd_start_scan)
      */spple_demo.o(.text.mscd_attach_handles)
      */spple_demo.o(.text.PHYToString)
      */spple_demo.o(.text.Initialize_SPPLE_Demo)
      */spple_demo.o(.text.GetBluetoothStackID)
      */spple_demo.o(.text.GetConnectionID)
      */spple_demo.o(.text.StrToBD_ADDR)
      */spple_demo.o(.text.ExtendedConnect)
      */spple_demo.o(.text.ReadOTAImage)
      */spple_demo.o(.text.QueryOTAImage)
      */spple_demo.o(.text.DiscoverOTA)
      */spple_demo.o(.text.StartRXTest)
      */spple_demo.o(.text.StartTXTest)
      */spple_demo.o(.text.SetTestDataPeriod)
      */spple_demo.o(.text.SetAuthenticatedPayloadTimeout)
      */spple_demo.o(.text.RemoveDeviceFromResolvingList)
      */spple_demo.o(.text.AddDeviceToResolvingList)
      */spple_demo.o(.text.RemoveDeviceFromWhiteList)
      */spple_demo.o(.text.AddDeviceToWhiteList)
      */spple_demo.o(.text.ConnectLE)
      */spple_demo.o(.text.AdvertiseLE)
      */spple_demo.o(.rodata)
      */spple_demo.o(.rodata.str1.4)
      */ble_ota_service.o(.text)
      */ble_ota_service.o(.text.OTA_ClientCallback)
      */ble_ota_service.o(.text.GATT_ServerEventCallback_MotDet)
      */ble_ota_service.o(.text.GATT_ServerEventCallback_OTA)
      */ble_ota_service.o(.text.OTA_Client_Connection_Event_Callback)
      */ble_ota_service.o(.text.BLE_OTA_Service_Discovery_Callback)
      */ble_ota_service.o(.text.RegisterMotDet_Service)
      */ble_ota_service.o(.text.BLE_OTA_Initialize_Service)
      */ble_ota_service.o(.text.BLE_OTA_Cleanup_Service)
      */ble_ota_service.o(.text.BLE_OTA_Register_Image)
      */ble_ota_service.o(.text.BLE_OTA_Unregister_Image)
      */ble_ota_service.o(.text.BLE_OTA_Get_Registered_Images)
      */ble_ota_service.o(.text.BLE_OTA_Image_Data_Response)
      */ble_ota_service.o(.text.BLE_OTA_Initialize_Client)
      */ble_ota_service.o(.text.BLE_OTA_Cleanup_Client)
      */ble_ota_service.o(.text.BLE_OTA_Discover_OTA_Service)
      */ble_ota_service.o(.text.BLE_OTA_Query_Image)
      */ble_ota_service.o(.text.BLE_OTA_Read_Image_Data)
      */ble_ota_service.o(.rodata)
      */ble_ota_service.o(.rodata.str1.4)
      */sensors_demo.o(.text)
      */sensors_demo.o(.text.sensors_pir)
      */sensors_demo.o(.text.Initialize_Sensors_Demo)
      */sensors_demo.o(.rodata)
      */sensors_demo.o(.rodata.str1.4)
      */sensors.o(.text)
      */sensors.o(.text.pir_int_callback)
      */sensors.o(.text.mscd_timer_callback)
      */sensors.o(.text.pir_thread)
      */sensors.o(.text.mscd_thread)
      */sensors.o(.text.mot_print)
      */sensors.o(.text.mot_rate_func)
      */sensors.o(.text.mscd_scan_stopped_callback)
      */sensors.o(.text.mscd_disconnection_result_callback)
      */sensors.o(.text.mscd_scan_result_callback)
      */sensors.o(.text.mscd_connection_result_callback)
      */sensors.o(.text.mscd_service_discovery_callback)
      */sensors.o(.text.mscd_scan_result)
      */sensors.o(.text.mscd_connection_result)
      */sensors.o(.text.mscd_disconnection_result)
      */sensors.o(.text.mscd_service_discovery_result)
      */sensors.o(.text.mscd_thread_stop_callback)
      */sensors.o(.text.mscd_write_callback)
      */sensors.o(.text.mscd_demo_init)
      */sensors.o(.text.sensors_pir_driver_test)
      */sensors.o(.rodata.str1.4)
      */UsrEDL.o(.text)
   } >XIP_RO_MEMORY : XIP_SEGMENT
   
   /* RAM_FOM_APPS_CODE_SEGMENT */
   RAM_FOM_APPS_RO_REGION :
   {
      *(.conststring)
      *(.constdata)
      *(.rodata*)
      *(RAM_FOM_APPS_RO_SECTION)
      */qcli.o(.text)
      */qcli.o(.text.Find_Command)
      */qcli.o(.text.Unregister_Command_Group)
      */qcli.o(.text.QCLI_Initialize)
      */qcli.o(.text.QCLI_Register_Command_Group)
      */qcli.o(.text.QCLI_Printf)
      */qcli.o(.text.Command_Exit)
      */qcli.o(.text.Display_Usage)
      */qcli.o(.text.Display_Group_Name.isra.1)
      */qcli.o(.text.Display_Command_List)
      */qcli.o(.text.Display_Help)
      */qcli.o(.text.Command_Root)
      */qcli.o(.text.Command_Up)
      */qcli.o(.text.Command_Help)
      */qcli.o(.text.Command_Ver)
      */qcli.o(.text.QCLI_Display_Prompt)
      */qcli.o(.text.QCLI_Process_Input_Data)
      */qcli.o(.text.Command_Thread)
      */qcli.o(.text.QCLI_Display_Command_List)
      */qcli.o(.text.QCLI_Unregister_Command_Group)
      */qcli.o(.rodata)
      */qcli.o(.rodata.str1.4)
      */qcli_util.o(.text)
      */qcli_util.o(.text.Memcmpi)
      */qcli_util.o(.text.Hex_Nibble_To_Int)
      */qcli_util.o(.text.String_To_Integer)
      */qcli_util.o(.text.Hex_String_To_ULL)
      */qcli_util.o(.text.Hex_String_To_Array)
      */qcli_util.o(.text.Verify_Integer_Parameter)
      */qcli_util.o(.text.Verify_Unsigned_Integer_Parameter)
      */qcli_util.o(.text.Status_To_String)
      */qcli_util.o(.text.Display_Function_Success)
      */qcli_util.o(.text.Display_Function_Error)
      */qcli_util.o(.text.Dump_Data)
      */qcli_util.o(.rodata)
      */qcli_util.o(.rodata.str1.4)
      */pal.o(.text)
      */pal.o(.text.QCLI_Thread)
      */pal.o(.text.Uart_Rx_CB)
      */pal.o(.text.Uart_Tx_CB)
      */pal.o(.text.app_trigger_signal_on_GPIO)
      */pal.o(.text.app_trigger_signal_release_GPIO)
      */pal.o(.text.PAL_Uart_Init)
      */pal.o(.text.PAL_Uart_Deinit)
      */pal.o(.text.PAL_Console_Write)
      */pal.o(.text.app_init)
      */pal.o(.text.app_start)
      */pal.o(.text.PAL_Exit)
      */pal.o(.text.PAL_Reset)
      */pal.o(.rodata.str1.4)
      */lp_demo.o(.text)
      */lp_demo.o(.text.Cmd_Reset_OM_Test_Vectors)
      */lp_demo.o(.text.Cmd_Uart)
      */lp_demo.o(.text.Cmd_Start_OM_Transition_tests)
      */lp_demo.o(.text.Cmd_Deep_Sleep)
      */lp_demo.o(.text.Initialize_LP_Demo)
      */lp_demo.o(.rodata)
      */lp_demo.o(.rodata.str1.4)
      */fom_lp_test.o(.text)
      */fom_lp_test.o(.text.om_transition_test_cb)
      */fom_lp_test.o(.text.lp_timer_sleep_cb)
      */fom_lp_test.o(.text.lp_uart_cb)
      */fom_lp_test.o(.text.initialize_test_vectors)
      */fom_lp_test.o(.text.reset_OM_Test_Vectors)
      */fom_lp_test.o(.text.om_transition_test)
      */fom_lp_test.o(.text.fom_register_operating_modes)
      */fom_lp_test.o(.text.set_sleep)
      */fom_lp_test.o(.text.disable_uart)
      */fom_lp_test.o(.text.log_app_entry_time)
      */fom_lp_test.o(.text.print_test_kpi)
      */fom_lp_test.o(.rodata.str1.4)
      */platform_oem.o(.text)
   } >RAM_FOM_APPS_RO_MEMORY : RAM_FOM_APPS_CODE_SEGMENT

   /* RAM_FOM_BSP_CODE_SEGMENT */
   RAM_FOM_BSP_RO_REGION :
   {
      *(.text)

      /* Needed for C++ static constructors. See __initialize_cpp__aeabi_ */
      PROVIDE_HIDDEN(__init_array_begin = .);
      *(.init_array*)
      PROVIDE_HIDDEN(__init_array_end = .);
      */threadx.lib:tx_initialize_low_level.o(.text)
      */threadx.lib:tx_thread_stack_build.o(.text)
      */threadx.lib:tx_thread_schedule.o(.text)
      */threadx.lib:tx_thread_context_save.o(.text)
      */threadx.lib:tx_thread_context_restore.o(.text)
      */threadx.lib:tx_thread_interrupt_control.o(.text)
      */threadx.lib:tx_timer_interrupt.o(.text)
      */threadx.lib:tx_block_allocate.o(.text)
      */threadx.lib:tx_block_pool_cleanup.o(.text)
      */threadx.lib:tx_block_pool_create.o(.text)
      */threadx.lib:tx_block_pool_delete.o(.text)
      */threadx.lib:tx_block_pool_info_get.o(.text)
      */threadx.lib:tx_block_pool_initialize.o(.text)
      */threadx.lib:tx_block_pool_performance_info_get.o(.text)
      */threadx.lib:tx_block_pool_performance_system_info_get.o(.text)
      */threadx.lib:tx_block_pool_prioritize.o(.text)
      */threadx.lib:tx_block_release.o(.text)
      */threadx.lib:tx_byte_allocate.o(.text)
      */threadx.lib:tx_byte_pool_cleanup.o(.text)
      */threadx.lib:tx_byte_pool_create.o(.text)
      */threadx.lib:tx_byte_pool_delete.o(.text)
      */threadx.lib:tx_byte_pool_info_get.o(.text)
      */threadx.lib:tx_byte_pool_initialize.o(.text)
      */threadx.lib:tx_byte_pool_performance_info_get.o(.text)
      */threadx.lib:tx_byte_pool_performance_system_info_get.o(.text)
      */threadx.lib:tx_byte_pool_prioritize.o(.text)
      */threadx.lib:tx_byte_pool_search.o(.text)
      */threadx.lib:tx_byte_release.o(.text)
      */threadx.lib:tx_event_flags_cleanup.o(.text)
      */threadx.lib:tx_event_flags_create.o(.text)
      */threadx.lib:tx_event_flags_delete.o(.text)
      */threadx.lib:tx_event_flags_get.o(.text)
      */threadx.lib:tx_event_flags_info_get.o(.text)
      */threadx.lib:tx_event_flags_initialize.o(.text)
      */threadx.lib:tx_event_flags_performance_info_get.o(.text)
      */threadx.lib:tx_event_flags_performance_system_info_get.o(.text)
      */threadx.lib:tx_event_flags_set.o(.text)
      */threadx.lib:tx_event_flags_set_notify.o(.text)
      */threadx.lib:tx_initialize_high_level.o(.text)
      */threadx.lib:tx_initialize_kernel_enter.o(.text)
      */threadx.lib:tx_initialize_kernel_setup.o(.text)
      */threadx.lib:tx_mutex_cleanup.o(.text)
      */threadx.lib:tx_mutex_create.o(.text)
      */threadx.lib:tx_mutex_delete.o(.text)
      */threadx.lib:tx_mutex_get.o(.text)
      */threadx.lib:tx_mutex_info_get.o(.text)
      */threadx.lib:tx_mutex_initialize.o(.text)
      */threadx.lib:tx_mutex_performance_info_get.o(.text)
      */threadx.lib:tx_mutex_performance_system_info_get.o(.text)
      */threadx.lib:tx_mutex_prioritize.o(.text)
      */threadx.lib:tx_mutex_priority_change.o(.text)
      */threadx.lib:tx_mutex_put.o(.text)
      */threadx.lib:tx_queue_cleanup.o(.text)
      */threadx.lib:tx_queue_create.o(.text)
      */threadx.lib:tx_queue_delete.o(.text)
      */threadx.lib:tx_queue_flush.o(.text)
      */threadx.lib:tx_queue_front_send.o(.text)
      */threadx.lib:tx_queue_info_get.o(.text)
      */threadx.lib:tx_queue_initialize.o(.text)
      */threadx.lib:tx_queue_performance_info_get.o(.text)
      */threadx.lib:tx_queue_performance_system_info_get.o(.text)
      */threadx.lib:tx_queue_prioritize.o(.text)
      */threadx.lib:tx_queue_receive.o(.text)
      */threadx.lib:tx_queue_send.o(.text)
      */threadx.lib:tx_queue_send_notify.o(.text)
      */threadx.lib:tx_semaphore_ceiling_put.o(.text)
      */threadx.lib:tx_semaphore_cleanup.o(.text)
      */threadx.lib:tx_semaphore_create.o(.text)
      */threadx.lib:tx_semaphore_delete.o(.text)
      */threadx.lib:tx_semaphore_get.o(.text)
      */threadx.lib:tx_semaphore_info_get.o(.text)
      */threadx.lib:tx_semaphore_initialize.o(.text)
      */threadx.lib:tx_semaphore_performance_info_get.o(.text)
      */threadx.lib:tx_semaphore_performance_system_info_get.o(.text)
      */threadx.lib:tx_semaphore_prioritize.o(.text)
      */threadx.lib:tx_semaphore_put.o(.text)
      */threadx.lib:tx_semaphore_put_notify.o(.text)
      */threadx.lib:tx_thread_create.o(.text)
      */threadx.lib:tx_thread_delete.o(.text)
      */threadx.lib:tx_thread_entry_exit_notify.o(.text)
      */threadx.lib:tx_thread_identify.o(.text)
      */threadx.lib:tx_thread_info_get.o(.text)
      */threadx.lib:tx_thread_sleep_info_get.o(.text)
      */threadx.lib:tx_thread_initialize.o(.emb_text)
      */threadx.lib:tx_thread_initialize.o(.text)
      */threadx.lib:tx_thread_initialize.o(.constdata)
      */threadx.lib:tx_thread_performance_info_get.o(.text)
      */threadx.lib:tx_thread_performance_system_info_get.o(.text)
      */threadx.lib:tx_thread_preemption_change.o(.text)
      */threadx.lib:tx_thread_priority_change.o(.text)
      */threadx.lib:tx_thread_relinquish.o(.text)
      */threadx.lib:tx_thread_reset.o(.text)
      */threadx.lib:tx_thread_resume.o(.text)
      */threadx.lib:tx_thread_shell_entry.o(.text)
      */threadx.lib:tx_thread_sleep.o(.text)
      */threadx.lib:tx_thread_stack_analyze.o(.text)
      */threadx.lib:tx_thread_stack_error_handler.o(.text)
      */threadx.lib:tx_thread_stack_error_notify.o(.text)
      */threadx.lib:tx_thread_suspend.o(.text)
      */threadx.lib:tx_thread_system_preempt_check.o(.text)
      */threadx.lib:tx_thread_system_resume.o(.text)
      */threadx.lib:tx_thread_system_suspend.o(.text)
      */threadx.lib:tx_thread_terminate.o(.text)
      */threadx.lib:tx_thread_time_slice.o(.text)
      */threadx.lib:tx_thread_time_slice_change.o(.text)
      */threadx.lib:tx_thread_timeout.o(.text)
      */threadx.lib:tx_thread_wait_abort.o(.text)
      */threadx.lib:tx_time_get.o(.text)
      */threadx.lib:tx_time_set.o(.text)
      */threadx.lib:tx_timer_activate.o(.text)
      */threadx.lib:tx_timer_change.o(.text)
      */threadx.lib:tx_timer_create.o(.text)
      */threadx.lib:tx_timer_deactivate.o(.text)
      */threadx.lib:tx_timer_delete.o(.text)
      */threadx.lib:tx_timer_expiration_process.o(.text)
      */threadx.lib:tx_timer_info_get.o(.text)
      */threadx.lib:tx_timer_initialize.o(.text)
      */threadx.lib:tx_timer_performance_info_get.o(.text)
      */threadx.lib:tx_timer_performance_system_info_get.o(.text)
      */threadx.lib:tx_timer_system_activate.o(.text)
      */threadx.lib:tx_timer_system_deactivate.o(.text)
      */threadx.lib:tx_timer_thread_entry.o(.text)
      */threadx.lib:tx_trace_buffer_full_notify.o(.text)
      */threadx.lib:tx_trace_enable.o(.text)
      */threadx.lib:tx_trace_event_filter.o(.text)
      */threadx.lib:tx_trace_event_unfilter.o(.text)
      */threadx.lib:tx_trace_disable.o(.text)
      */threadx.lib:tx_trace_initialize.o(.text)
      */threadx.lib:tx_trace_interrupt_control.o(.text)
      */threadx.lib:tx_trace_isr_enter_insert.o(.text)
      */threadx.lib:tx_trace_isr_exit_insert.o(.text)
      */threadx.lib:tx_trace_object_register.o(.text)
      */threadx.lib:tx_trace_object_unregister.o(.text)
      */threadx.lib:tx_trace_user_event_insert.o(.text)
      */threadx.lib:txe_block_allocate.o(.text)
      */threadx.lib:txe_block_pool_create.o(.text)
      */threadx.lib:txe_block_pool_delete.o(.text)
      */threadx.lib:txe_block_pool_info_get.o(.text)
      */threadx.lib:txe_block_pool_prioritize.o(.text)
      */threadx.lib:txe_block_release.o(.text)
      */threadx.lib:txe_byte_allocate.o(.text)
      */threadx.lib:txe_byte_pool_create.o(.text)
      */threadx.lib:txe_byte_pool_delete.o(.text)
      */threadx.lib:txe_byte_pool_info_get.o(.text)
      */threadx.lib:txe_byte_pool_prioritize.o(.text)
      */threadx.lib:txe_byte_release.o(.text)
      */threadx.lib:txe_event_flags_create.o(.text)
      */threadx.lib:txe_event_flags_delete.o(.text)
      */threadx.lib:txe_event_flags_get.o(.text)
      */threadx.lib:txe_event_flags_info_get.o(.text)
      */threadx.lib:txe_event_flags_set.o(.text)
      */threadx.lib:txe_event_flags_set_notify.o(.text)
      */threadx.lib:txe_mutex_create.o(.text)
      */threadx.lib:txe_mutex_delete.o(.text)
      */threadx.lib:txe_mutex_get.o(.text)
      */threadx.lib:txe_mutex_info_get.o(.text)
      */threadx.lib:txe_mutex_prioritize.o(.text)
      */threadx.lib:txe_mutex_put.o(.text)
      */threadx.lib:txe_queue_create.o(.text)
      */threadx.lib:txe_queue_delete.o(.text)
      */threadx.lib:txe_queue_flush.o(.text)
      */threadx.lib:txe_queue_front_send.o(.text)
      */threadx.lib:txe_queue_info_get.o(.text)
      */threadx.lib:txe_queue_prioritize.o(.text)
      */threadx.lib:txe_queue_receive.o(.text)
      */threadx.lib:txe_queue_send.o(.text)
      */threadx.lib:txe_queue_send_notify.o(.text)
      */threadx.lib:txe_semaphore_ceiling_put.o(.text)
      */threadx.lib:txe_semaphore_create.o(.text)
      */threadx.lib:txe_semaphore_delete.o(.text)
      */threadx.lib:txe_semaphore_get.o(.text)
      */threadx.lib:txe_semaphore_info_get.o(.text)
      */threadx.lib:txe_semaphore_prioritize.o(.text)
      */threadx.lib:txe_semaphore_put.o(.text)
      */threadx.lib:txe_semaphore_put_notify.o(.text)
      */threadx.lib:txe_thread_create.o(.text)
      */threadx.lib:txe_thread_delete.o(.text)
      */threadx.lib:txe_thread_entry_exit_notify.o(.text)
      */threadx.lib:txe_thread_info_get.o(.text)
      */threadx.lib:txe_thread_preemption_change.o(.text)
      */threadx.lib:txe_thread_priority_change.o(.text)
      */threadx.lib:txe_thread_relinquish.o(.text)
      */threadx.lib:txe_thread_reset.o(.text)
      */threadx.lib:txe_thread_resume.o(.text)
      */threadx.lib:txe_thread_suspend.o(.text)
      */threadx.lib:txe_thread_terminate.o(.text)
      */threadx.lib:txe_thread_time_slice_change.o(.text)
      */threadx.lib:txe_thread_wait_abort.o(.text)
      */threadx.lib:txe_timer_activate.o(.text)
      */threadx.lib:txe_timer_change.o(.text)
      */threadx.lib:txe_timer_create.o(.text)
      */threadx.lib:txe_timer_deactivate.o(.text)
      */threadx.lib:txe_timer_delete.o(.text)
      */threadx.lib:txe_timer_info_get.o(.text)
      */core.lib:tlmm_boot.o(.text)
      */core.lib:platform_internal.o(.text)
      */core.lib:platform_internal.o(.constdata)
      */core.lib:platform_internal.o(.conststring)
      */core.lib:platform_internal.o(i.diag_available)
      */core.lib:platform_startup.o(QUARTZ_ENTRY)
      */qurt.lib:qurt_init.o(.text)
      */qurt.lib:qurt_init.o(.constdata)
      */qurt.lib:qurt_init.o(.conststring)
      */qurt.lib:qurt_thread.o(.text)
      */qurt.lib:qurt_thread.o(.constdata)
      */qurt.lib:qurt_thread.o(.conststring)
      */qurt.lib:qurt_signal.o(.text)
      */qurt.lib:qurt_signal.o(.constdata)
      */qurt.lib:qurt_signal.o(.conststring)
      */qurt.lib:qurt_pimutex.o(.text)
      */qurt.lib:qurt_pimutex.o(.constdata)
      */qurt.lib:qurt_pimutex.o(.conststring)
      */qurt.lib:qurt_pipe.o(.text)
      */qurt.lib:qurt_pipe.o(.constdata)
      */qurt.lib:qurt_pipe.o(.conststring)
      */qurt.lib:qurt_timer.o(.text)
      */qurt.lib:qurt_timer.o(.constdata)
      */qurt.lib:qurt_timer.o(.conststring)
      */qurt.lib:qurt_system.o(.emb_text)
      */qurt.lib:qurt_system.o(.text)
      */net_ram.lib:ssl_task.o(.text)
      */net_ram.lib:ssl_task.o(.conststring)
      */net_ram.lib:ssl_task.o(i.diag_available)
      */v2core.lib:ram_function_table_fom.o(.text)
      */v2core.lib:ram_function_table_fom.o(i.diag_available)
      */patch.lib:patch_ssl_ram.o(.text)
      */patch.lib:patch_ssl_ram.o(.constdata)
      */patch.lib:patch_ssl_ram.o(.conststring)
      */patch.lib:patch_SharkSslCon_DTLS.o(.text)
      */patch.lib:patch_SharkSslCon_DTLS.o(.constdata)
      */patch.lib:patch_SharkSslCon_DTLS.o(.conststring)
      */patch.lib:patch_cksum.o(.text)
      */patch.lib:patch_socket2.o(.text)
      */patch.lib:patch_qcc_digest.o(.text)
      */patch.lib:patch_aes_gcm_ghash.o(.text)
      */patch.lib:patch_qapi_socket_txrx.o(.text)
      */patch.lib:patch_driver_txrx.o(.text)
      */patch.lib:patch_SharkSSLCon.o(.text)
      */patch.lib:patch_SharkSSLCon.o(.constdata)
      */patch.lib:patch_SharkSSLCon.o(.conststring)
      */patch.lib:patch_SharkSslCrypto.o(.text)
      */patch.lib:patch_SharkSslCrypto.o(.constdata)
      */patch.lib:patch_hmac_aes.o(.text)
      */patch.lib:patch_driver_netbuf.o(.text)
      */patch.lib:patch_driver_netbuf.o(i.diag_available)
      */patch.lib:patch_SharkSslCipher.o(.text)
      */patch.lib:patch_SharkSslCipher.o(.constdata)
      */patch.lib:patch_SharkSslCipher.o(.conststring)
      */patch.lib:patch_SharkSslCryptoLib.o(.text)
      */patch.lib:patch_SharkSslCryptoLib.o(.constdata)
      */patch.lib:patch_aes.o(.text)
      */patch.lib:patch_cust_api_stack_txrx.o(.text)
      */patch.lib:patch_tcp_in.o(.text)
      */patch.lib:patch_iprcv.o(.text)
      */patch.lib:patch_hmac_hw.o(.text)
      *(RAM_FOM_BSP_RO_SECTION)
   } >RAM_FOM_BSP_RO_MEMORY : RAM_FOM_BSP_CODE_SEGMENT

   RAM_FOM_BSP_ZI_REGION :
   {
     */threadx.lib:tx_initialize_high_level.o(.bss)
     */threadx.lib:tx_initialize_high_level.o(COMMON)
     */threadx.lib:tx_thread_initialize.o(.bss)
     */threadx.lib:tx_thread_initialize.o(COMMON)
     */threadx.lib:tx_timer_initialize.o(.bss)
     */threadx.lib:tx_timer_initialize.o(COMMON)
     */core.lib:keypad.o(.bss)
     */core.lib:keypad.o(COMMON)
     */core.lib:usb_compile_wrapper.o(.bss)
     */core.lib:usb_compile_wrapper.o(COMMON)
     */core.lib:qusb_log.o(.bss)
     */core.lib:qusb_log.o(COMMON)
     */core.lib:qusb_fd.o(.bss)
     */core.lib:qusb_fd.o(COMMON)
     */core.lib:tlmm_boot.o(.bss)
     */core.lib:tlmm_boot.o(COMMON)
     */core.lib:sdio_mbox.o(.bss)
     */core.lib:sdio_mbox.o(COMMON)
     */core.lib:platform_calibration.o(.bss)
     */core.lib:platform_calibration.o(COMMON)
     */core.lib:htc_slave.o(.bss)
     */core.lib:htc_slave.o(COMMON)
     */core.lib:diag_transport.o(.bss)
     */core.lib:diag_transport.o(COMMON)
     */core.lib:diag_transport_glink.o(.bss)
     */core.lib:diag_transport_glink.o(COMMON)
     */core.lib:diag_transport_uart.o(.bss)
     */core.lib:diag_transport_uart.o(COMMON)
     */core.lib:diag_transport_usb.o(.bss)
     */core.lib:diag_transport_usb.o(COMMON)
     */core.lib:diag_transport_flash.o(.bss)
     */core.lib:diag_transport_flash.o(COMMON)
     */core.lib:diag_cli.o(.bss)
     */core.lib:diag_cli.o(COMMON)
     */core.lib:diag_binary_log.o(.bss)
     */core.lib:diag_binary_log.o(COMMON)
     */core.lib:diagpkt.o(.bss)
     */core.lib:diagpkt.o(COMMON)
     */core.lib:platform_internal.o(.bss)
     */core.lib:platform_internal.o(COMMON)
     */core.lib:xport_quartz.o(.bss)
     */core.lib:xport_quartz.o(COMMON)
     */core.lib:glink_core_internal.o(.bss)
     */core.lib:glink_core_internal.o(COMMON)
     */core.lib:fs.o(.bss)
     */core.lib:fs.o(COMMON)
     */core.lib:fs_api.o(.bss)
     */core.lib:fs_api.o(COMMON)
     */core.lib:fs_bdev.o(.bss)
     */core.lib:fs_bdev.o(COMMON)
     */core.lib:fs_bdev_spinor.o(.bss)
     */core.lib:fs_bdev_spinor.o(COMMON)
     */core.lib:fs_desc.o(.bss)
     */core.lib:fs_desc.o(COMMON)
     */core.lib:fs_ffs.o(.bss)
     */core.lib:fs_ffs.o(COMMON)
     */core.lib:fs_ffs_iter.o(.bss)
     */core.lib:fs_ffs_iter.o(COMMON)
     */core.lib:fs_ffs_sb.o(.bss)
     */core.lib:fs_ffs_sb.o(COMMON)
     */core.lib:fs_global_lock.o(.bss)
     */core.lib:fs_global_lock.o(COMMON)
     */core.lib:fs_mount.o(.bss)
     */core.lib:fs_mount.o(COMMON)
     */core.lib:fs_vnode.o(.bss)
     */core.lib:fs_vnode.o(COMMON)
     */core.lib:fs_osal_heap.o(.bss)
     */core.lib:fs_osal_heap.o(COMMON)
     */core.lib:fs_diag.o(.bss)
     */core.lib:fs_diag.o(COMMON)
     */qurt.lib:qurt_init.o(.bss)
     */qurt.lib:qurt_init.o(COMMON)
     */qurt.lib:qurt_system.o(.bss)
     */qurt.lib:qurt_system.o(COMMON)
     */WLAN.lib:cust_api_ioctl.o(.bss)
     */WLAN.lib:cust_api_ioctl.o(COMMON)
     */WLAN.lib:cust_hw_api_ext.o(.bss)
     */WLAN.lib:cust_hw_api_ext.o(COMMON)
     */WLAN.lib:cust_platform_api.o(.bss)
     */WLAN.lib:cust_platform_api.o(COMMON)
     */WLAN.lib:cust_elf_loader.o(.bss)
     */WLAN.lib:cust_elf_loader.o(COMMON)
     */WLAN.lib:driver_suspend_resume.o(.bss)
     */WLAN.lib:driver_suspend_resume.o(COMMON)
     */net.lib:qapi_dhcpv4c.o(.bss)
     */net.lib:qapi_dhcpv4c.o(COMMON)
     */net.lib:qapi_dhcpv4s.o(.bss)
     */net.lib:qapi_dhcpv4s.o(COMMON)
     */net.lib:ns_v4.o(.bss)
     */net.lib:ns_v4.o(COMMON)
     */net.lib:ns_bridge.o(.bss)
     */net.lib:ns_bridge.o(COMMON)
     */net.lib:ssl_cert_store.o(.bss)
     */net.lib:ssl_cert_store.o(COMMON)
     */net_ram.lib:ssl_task.o(.bss)
     */net_ram.lib:ssl_task.o(COMMON)
     */dhcpv6c.lib:dhcpv6_mod.o(.bss)
     */dhcpv6c.lib:dhcpv6_mod.o(COMMON)
     */sntpc.lib:sntpclnt.o(.bss)
     */sntpc.lib:sntpclnt.o(COMMON)
     */dnssrvr.lib:dnssrvr.o(.bss)
     */dnssrvr.lib:dnssrvr.o(COMMON)
     */sharkssl.lib:SharkSslCon_hs.o(.bss)
     */sharkssl.lib:SharkSslCon_hs.o(COMMON)
     */cryptolib.lib:persistent_obj_mgmt.o(.bss)
     */cryptolib.lib:persistent_obj_mgmt.o(COMMON)
     */httpsvr.lib:htauth.o(.bss)
     */httpsvr.lib:htauth.o(COMMON)
     */httpsvr.lib:http.o(.bss)
     */httpsvr.lib:http.o(COMMON)
     */httpsvr.lib:http_mod.o(.bss)
     */httpsvr.lib:http_mod.o(COMMON)
     */httpsvr.lib:httpport.o(.bss)
     */httpsvr.lib:httpport.o(COMMON)
     */httpsvr.lib:wbs_mod.o(.bss)
     */httpsvr.lib:wbs_mod.o(COMMON)
     */httpsvr.lib:wbscgi.o(.bss)
     */httpsvr.lib:wbscgi.o(COMMON)
     */httpc.lib:http_client.o(.bss)
     */httpc.lib:http_client.o(COMMON)
     */mqttc.lib:mqttc.o(.bss)
     */mqttc.lib:mqttc.o(COMMON)
     */vfs.lib:vfsfiles.o(.bss)
     */vfs.lib:vfsfiles.o(COMMON)
     */userpass.lib:userpass.o(.bss)
     */userpass.lib:userpass.o(COMMON)
     */i2s.lib:i2s.o(.bss)
     */i2s.lib:i2s.o(COMMON)
     */i2s.lib:i2s_intr.o(.bss)
     */i2s.lib:i2s_intr.o(COMMON)
     */i2s.lib:i2s_api.o(.bss)
     */i2s.lib:i2s_api.o(COMMON)
     */nichestack.lib:mld_cmn.o(.bss)
     */nichestack.lib:mld_cmn.o(COMMON)
     */fwup.lib:qapi_firmware_upgrade.o(.bss)
     */fwup.lib:qapi_firmware_upgrade.o(COMMON)
     */fwup_engine.lib:fw_upgrade.o(.bss)
     */fwup_engine.lib:fw_upgrade.o(COMMON)
     */pka_port.lib:pka_host.o(.bss)
     */pka_port.lib:pka_host.o(COMMON)
     */zigbee.lib:zcl.o(.bss)
     */zigbee.lib:zcl.o(COMMON)
     */quartz_zigbee.lib:zigbee_os_port.o(.bss)
     */quartz_zigbee.lib:zigbee_os_port.o(COMMON)
     */quartz_zigbee.lib:zigbee_sec_port.o(.bss)
     */quartz_zigbee.lib:zigbee_sec_port.o(COMMON)
     */quartz_zigbee.lib:zigbee_mac_port.o(.bss)
     */quartz_zigbee.lib:zigbee_mac_port.o(COMMON)
     */quartz_zigbee.lib:qapi_zb.o(.bss)
     */quartz_zigbee.lib:qapi_zb.o(COMMON)
     */quartz_zigbee.lib:qapi_zb_nwk.o(.bss)
     */quartz_zigbee.lib:qapi_zb_nwk.o(COMMON)
     */quartz_zigbee.lib:qapi_zb_aps.o(.bss)
     */quartz_zigbee.lib:qapi_zb_aps.o(COMMON)
     */quartz_zigbee.lib:qapi_zb_zdp.o(.bss)
     */quartz_zigbee.lib:qapi_zb_zdp.o(COMMON)
     */quartz_zigbee.lib:qapi_zb_zgp.o(.bss)
     */quartz_zigbee.lib:qapi_zb_zgp.o(COMMON)
     */quartz_zigbee.lib:qapi_zb_interpan.o(.bss)
     */quartz_zigbee.lib:qapi_zb_interpan.o(COMMON)
     */quartz_zigbee.lib:qapi_zb_tp2.o(.bss)
     */quartz_zigbee.lib:qapi_zb_tp2.o(COMMON)
     */quartz_zigbee.lib:qapi_zb_cl.o(.bss)
     */quartz_zigbee.lib:qapi_zb_cl.o(COMMON)
     */mdns.lib:mdnsd.o(.bss)
     */mdns.lib:mdnsd.o(COMMON)
     */BLUETOPIA_SERVICES.lib:AIOS.o(.bss)
     */BLUETOPIA_SERVICES.lib:AIOS.o(COMMON)
     */BLUETOPIA_SERVICES.lib:ANS.o(.bss)
     */BLUETOPIA_SERVICES.lib:ANS.o(COMMON)
     */BLUETOPIA_SERVICES.lib:BAS.o(.bss)
     */BLUETOPIA_SERVICES.lib:BAS.o(COMMON)
     */BLUETOPIA_SERVICES.lib:BCS.o(.bss)
     */BLUETOPIA_SERVICES.lib:BCS.o(COMMON)
     */BLUETOPIA_SERVICES.lib:BLS.o(.bss)
     */BLUETOPIA_SERVICES.lib:BLS.o(COMMON)
     */BLUETOPIA_SERVICES.lib:BMS.o(.bss)
     */BLUETOPIA_SERVICES.lib:BMS.o(COMMON)
     */BLUETOPIA_SERVICES.lib:CGMS.o(.bss)
     */BLUETOPIA_SERVICES.lib:CGMS.o(COMMON)
     */BLUETOPIA_SERVICES.lib:CPS.o(.bss)
     */BLUETOPIA_SERVICES.lib:CPS.o(COMMON)
     */BLUETOPIA_SERVICES.lib:CSCS.o(.bss)
     */BLUETOPIA_SERVICES.lib:CSCS.o(COMMON)
     */BLUETOPIA_SERVICES.lib:CTS.o(.bss)
     */BLUETOPIA_SERVICES.lib:CTS.o(COMMON)
     */BLUETOPIA_SERVICES.lib:DIS.o(.bss)
     */BLUETOPIA_SERVICES.lib:DIS.o(COMMON)
     */BLUETOPIA_SERVICES.lib:ESS.o(.bss)
     */BLUETOPIA_SERVICES.lib:ESS.o(COMMON)
     */BLUETOPIA_SERVICES.lib:GAPS.o(.bss)
     */BLUETOPIA_SERVICES.lib:GAPS.o(COMMON)
     */BLUETOPIA_SERVICES.lib:GLS.o(.bss)
     */BLUETOPIA_SERVICES.lib:GLS.o(COMMON)
     */BLUETOPIA_SERVICES.lib:HIDS.o(.bss)
     */BLUETOPIA_SERVICES.lib:HIDS.o(COMMON)
     */BLUETOPIA_SERVICES.lib:HPS.o(.bss)
     */BLUETOPIA_SERVICES.lib:HPS.o(COMMON)
     */BLUETOPIA_SERVICES.lib:HRS.o(.bss)
     */BLUETOPIA_SERVICES.lib:HRS.o(COMMON)
     */BLUETOPIA_SERVICES.lib:HTS.o(.bss)
     */BLUETOPIA_SERVICES.lib:HTS.o(COMMON)
     */BLUETOPIA_SERVICES.lib:IAS.o(.bss)
     */BLUETOPIA_SERVICES.lib:IAS.o(COMMON)
     */BLUETOPIA_SERVICES.lib:IPS.o(.bss)
     */BLUETOPIA_SERVICES.lib:IPS.o(COMMON)
     */BLUETOPIA_SERVICES.lib:IPSP.o(.bss)
     */BLUETOPIA_SERVICES.lib:IPSP.o(COMMON)
     */BLUETOPIA_SERVICES.lib:LLS.o(.bss)
     */BLUETOPIA_SERVICES.lib:LLS.o(COMMON)
     */BLUETOPIA_SERVICES.lib:LNS.o(.bss)
     */BLUETOPIA_SERVICES.lib:LNS.o(COMMON)
     */BLUETOPIA_SERVICES.lib:NDCS.o(.bss)
     */BLUETOPIA_SERVICES.lib:NDCS.o(COMMON)
     */BLUETOPIA_SERVICES.lib:OTS.o(.bss)
     */BLUETOPIA_SERVICES.lib:OTS.o(COMMON)
     */BLUETOPIA_SERVICES.lib:PASS.o(.bss)
     */BLUETOPIA_SERVICES.lib:PASS.o(COMMON)
     */BLUETOPIA_SERVICES.lib:PLXS.o(.bss)
     */BLUETOPIA_SERVICES.lib:PLXS.o(COMMON)
     */BLUETOPIA_SERVICES.lib:RSCS.o(.bss)
     */BLUETOPIA_SERVICES.lib:RSCS.o(COMMON)
     */BLUETOPIA_SERVICES.lib:RTUS.o(.bss)
     */BLUETOPIA_SERVICES.lib:RTUS.o(COMMON)
     */BLUETOPIA_SERVICES.lib:SCPS.o(.bss)
     */BLUETOPIA_SERVICES.lib:SCPS.o(COMMON)
     */BLUETOPIA_SERVICES.lib:TPS.o(.bss)
     */BLUETOPIA_SERVICES.lib:TPS.o(COMMON)
     */BLUETOPIA_SERVICES.lib:TRDS.o(.bss)
     */BLUETOPIA_SERVICES.lib:TRDS.o(COMMON)
     */BLUETOPIA_SERVICES.lib:UDS.o(.bss)
     */BLUETOPIA_SERVICES.lib:UDS.o(COMMON)
     */BLUETOPIA_SERVICES.lib:WSS.o(.bss)
     */BLUETOPIA_SERVICES.lib:WSS.o(COMMON)
     */BLUETOPIA_QAPI_SERVICES.lib:BTPSIPv6.o(.bss)
     */BLUETOPIA_QAPI_SERVICES.lib:BTPSIPv6.o(COMMON)
     */BLUETOPIA_QAPI_SERVICES.lib:SLoWP.o(.bss)
     */BLUETOPIA_QAPI_SERVICES.lib:SLoWP.o(COMMON)
     */BLUETOPIA_QAPI_SERVICES.lib:qBSC.o(.bss)
     */BLUETOPIA_QAPI_SERVICES.lib:qBSC.o(COMMON)
     */BLUETOPIA_QAPI_SERVICES.lib:qAIOS.o(.bss)
     */BLUETOPIA_QAPI_SERVICES.lib:qAIOS.o(COMMON)
     */BLUETOPIA_QAPI_SERVICES.lib:qANS.o(.bss)
     */BLUETOPIA_QAPI_SERVICES.lib:qANS.o(COMMON)
     */BLUETOPIA_QAPI_SERVICES.lib:qBAS.o(.bss)
     */BLUETOPIA_QAPI_SERVICES.lib:qBAS.o(COMMON)
     */BLUETOPIA_QAPI_SERVICES.lib:qBCS.o(.bss)
     */BLUETOPIA_QAPI_SERVICES.lib:qBCS.o(COMMON)
     */BLUETOPIA_QAPI_SERVICES.lib:qBLS.o(.bss)
     */BLUETOPIA_QAPI_SERVICES.lib:qBLS.o(COMMON)
     */BLUETOPIA_QAPI_SERVICES.lib:qBMS.o(.bss)
     */BLUETOPIA_QAPI_SERVICES.lib:qBMS.o(COMMON)
     */BLUETOPIA_QAPI_SERVICES.lib:qCGMS.o(.bss)
     */BLUETOPIA_QAPI_SERVICES.lib:qCGMS.o(COMMON)
     */BLUETOPIA_QAPI_SERVICES.lib:qCPS.o(.bss)
     */BLUETOPIA_QAPI_SERVICES.lib:qCPS.o(COMMON)
     */BLUETOPIA_QAPI_SERVICES.lib:qCSCS.o(.bss)
     */BLUETOPIA_QAPI_SERVICES.lib:qCSCS.o(COMMON)
     */BLUETOPIA_QAPI_SERVICES.lib:qCTS.o(.bss)
     */BLUETOPIA_QAPI_SERVICES.lib:qCTS.o(COMMON)
     */BLUETOPIA_QAPI_SERVICES.lib:qDIS.o(.bss)
     */BLUETOPIA_QAPI_SERVICES.lib:qDIS.o(COMMON)
     */BLUETOPIA_QAPI_SERVICES.lib:qESS.o(.bss)
     */BLUETOPIA_QAPI_SERVICES.lib:qESS.o(COMMON)
     */BLUETOPIA_QAPI_SERVICES.lib:qGAPS.o(.bss)
     */BLUETOPIA_QAPI_SERVICES.lib:qGAPS.o(COMMON)
     */BLUETOPIA_QAPI_SERVICES.lib:qGLS.o(.bss)
     */BLUETOPIA_QAPI_SERVICES.lib:qGLS.o(COMMON)
     */BLUETOPIA_QAPI_SERVICES.lib:qHIDS.o(.bss)
     */BLUETOPIA_QAPI_SERVICES.lib:qHIDS.o(COMMON)
     */BLUETOPIA_QAPI_SERVICES.lib:qHPS.o(.bss)
     */BLUETOPIA_QAPI_SERVICES.lib:qHPS.o(COMMON)
     */BLUETOPIA_QAPI_SERVICES.lib:qHRS.o(.bss)
     */BLUETOPIA_QAPI_SERVICES.lib:qHRS.o(COMMON)
     */BLUETOPIA_QAPI_SERVICES.lib:qHTS.o(.bss)
     */BLUETOPIA_QAPI_SERVICES.lib:qHTS.o(COMMON)
     */BLUETOPIA_QAPI_SERVICES.lib:qIAS.o(.bss)
     */BLUETOPIA_QAPI_SERVICES.lib:qIAS.o(COMMON)
     */BLUETOPIA_QAPI_SERVICES.lib:qIPS.o(.bss)
     */BLUETOPIA_QAPI_SERVICES.lib:qIPS.o(COMMON)
     */BLUETOPIA_QAPI_SERVICES.lib:qIPSP.o(.bss)
     */BLUETOPIA_QAPI_SERVICES.lib:qIPSP.o(COMMON)
     */BLUETOPIA_QAPI_SERVICES.lib:qLLS.o(.bss)
     */BLUETOPIA_QAPI_SERVICES.lib:qLLS.o(COMMON)
     */BLUETOPIA_QAPI_SERVICES.lib:qLNS.o(.bss)
     */BLUETOPIA_QAPI_SERVICES.lib:qLNS.o(COMMON)
     */BLUETOPIA_QAPI_SERVICES.lib:qNDCS.o(.bss)
     */BLUETOPIA_QAPI_SERVICES.lib:qNDCS.o(COMMON)
     */BLUETOPIA_QAPI_SERVICES.lib:qOTS.o(.bss)
     */BLUETOPIA_QAPI_SERVICES.lib:qOTS.o(COMMON)
     */BLUETOPIA_QAPI_SERVICES.lib:qPASS.o(.bss)
     */BLUETOPIA_QAPI_SERVICES.lib:qPASS.o(COMMON)
     */BLUETOPIA_QAPI_SERVICES.lib:qPLXS.o(.bss)
     */BLUETOPIA_QAPI_SERVICES.lib:qPLXS.o(COMMON)
     */BLUETOPIA_QAPI_SERVICES.lib:qRSCS.o(.bss)
     */BLUETOPIA_QAPI_SERVICES.lib:qRSCS.o(COMMON)
     */BLUETOPIA_QAPI_SERVICES.lib:qRTUS.o(.bss)
     */BLUETOPIA_QAPI_SERVICES.lib:qRTUS.o(COMMON)
     */BLUETOPIA_QAPI_SERVICES.lib:qSCPS.o(.bss)
     */BLUETOPIA_QAPI_SERVICES.lib:qSCPS.o(COMMON)
     */BLUETOPIA_QAPI_SERVICES.lib:qSLoWP.o(.bss)
     */BLUETOPIA_QAPI_SERVICES.lib:qSLoWP.o(COMMON)
     */BLUETOPIA_QAPI_SERVICES.lib:qTPS.o(.bss)
     */BLUETOPIA_QAPI_SERVICES.lib:qTPS.o(COMMON)
     */BLUETOPIA_QAPI_SERVICES.lib:qTRDS.o(.bss)
     */BLUETOPIA_QAPI_SERVICES.lib:qTRDS.o(COMMON)
     */BLUETOPIA_QAPI_SERVICES.lib:qUDS.o(.bss)
     */BLUETOPIA_QAPI_SERVICES.lib:qUDS.o(COMMON)
     */BLUETOPIA_QAPI_SERVICES.lib:qWSS.o(.bss)
     */BLUETOPIA_QAPI_SERVICES.lib:qWSS.o(COMMON)
     */dnssd.lib:dnssd.o(.bss)
     */dnssd.lib:dnssd.o(COMMON)
     */otp_tlv.lib:otp_tlv_read.o(.bss)
     */otp_tlv.lib:otp_tlv_read.o(COMMON)
     */otp_tlv.lib:swintr_setup.o(.bss)
     */otp_tlv.lib:swintr_setup.o(COMMON)
     */otp_tlv.lib:dbgcall.o(.bss)
     */otp_tlv.lib:dbgcall.o(COMMON)
     */json.lib:json.o(.bss)
     */json.lib:json.o(COMMON)
     */WLAN_QAPI.lib:qapi_wlan_base.o(.bss)
     */WLAN_QAPI.lib:qapi_wlan_base.o(COMMON)
     */wlan_lib_common_xip.lib:wlan_lib_port.o(.bss)
     */wlan_lib_common_xip.lib:wlan_lib_port.o(COMMON)
     */wlan_lib_common_xip.lib:wlan_lib_dbg.o(.bss)
     */wlan_lib_common_xip.lib:wlan_lib_dbg.o(COMMON)
     */tlv_transport.lib:tlv_transport.o(.bss)
     */tlv_transport.lib:tlv_transport.o(COMMON)
     */tee_master.lib:tee_master.o(.bss)
     */tee_master.lib:tee_master.o(COMMON)
     */dnsclient.lib:dnsclnt.o(.bss)
     */dnsclient.lib:dnsclnt.o(COMMON)
     */securefs.lib:securefs_lock.o(.bss)
     */securefs.lib:securefs_lock.o(COMMON)
     */v2core.lib:rfs_server.o(.bss)
     */v2core.lib:rfs_server.o(COMMON)
     */v2core.lib:rfs_server_pkt.o(.bss)
     */v2core.lib:rfs_server_pkt.o(COMMON)
     */EDLManager.lib:EDLManager.o(.bss)
     */EDLManager.lib:EDLManager.o(COMMON)
     */patch.lib:patch_cust_api_init.o(.bss)
     */patch.lib:patch_cust_api_init.o(COMMON)
     */patch.lib:patch_HCI.o(.bss)
     */patch.lib:patch_HCI.o(COMMON)
     */patch.lib:patch_coex.o(.bss)
     */patch.lib:patch_coex.o(COMMON)
     */patch.lib:patch_L2CAP.o(.bss)
     */patch.lib:patch_L2CAP.o(COMMON)
     */patch.lib:patch_qapi_hmi.o(.bss)
     */patch.lib:patch_qapi_hmi.o(COMMON)
      *(RAM_FOM_BSP_ZI_SECTION)
      
   } >RAM_FOM_BSP_DATA_MEMORY : RAM_FOM_BSP_DATA_SEGMENT

   RAM_FOM_BSP_RW_REGION :
   {
      */threadx.lib:tx_thread_initialize.o(.data)
      */core.lib:keypad.o(.data)
      */core.lib:qusb_dcd_ch9.o(.data)
      */core.lib:qusb_dci.o(.data)
      */core.lib:qusb_dci_4020.o(.data)
      */core.lib:qusb_fd.o(.data)
      */core.lib:platform_calibration.o(.data)
      */core.lib:diag_transport.o(.data)
      */core.lib:diag_transport_flash.o(.data)
      */core.lib:diagtools.o(.data)
      */core.lib:platform_internal.o(.data)
      */core.lib:xport_quartz.o(.data)
      */core.lib:glink_core_internal.o(.data)
      */core.lib:glink_core_intent_xport.o(.data)
      */core.lib:fs_api.o(.data)
      */core.lib:fs_util.o(.data)
      */core.lib:fs_diag.o(.data)
      */quartzplatform.lib:quartz_ram_function_table.o(RAM_FOM_BSP_ROM2RAM_INDIRECTION_TABLE_RW_SECTION_1)
      */WLAN.lib:cust_platform_api.o(.data)
      */WLAN.lib:wlan_secboot_sbl.o(.bss.BOOT_HASH_SEGMENT)
      */net.lib:ssl_cert_store.o(.data)
      */net.lib:net_devcfg.o(.data)
      */net.lib:ssl_control.o(.data)
      */net.lib:ssl_store_common.o(.data)
      */net_ram.lib:ssl_task.o(.data)
      */sntpc.lib:sntpclnt.o(.data)
      */sharkssl.lib:SharkSslCon_DTLS_hs.o(.data)
      */sharkssl.lib:SharkSslCon_DTLS_cust_hs.o(.data)
      */cryptolib.lib:persistent_obj_store.o(.data)
      */httpsvr.lib:htauth.o(.data)
      */httpsvr.lib:htutils.o(.data)
      */httpsvr.lib:webserver.o(.data)
      */httpc.lib:http_client.o(.data)
      */mqttc.lib:MQTTFormat.o(.data)
      */vfs.lib:vfsfiles.o(.data)
      */i2s.lib:i2s.o(.data)
      */fwup_engine.lib:fw_upgrade.o(.data)
      */zigbee.lib:zigbee.persist.o(.data)
      */zigbee.lib:zb.apsde.o(.data)
      */zigbee.lib:zb.nwk.nlme.nnt.o(.data)
      */zigbee.lib:zcl_test_profile_ep.o(.data)
      */BLUETOPIA_SERVICES.lib:AIOS.o(.data)
      */BLUETOPIA_SERVICES.lib:BAS.o(.data)
      */BLUETOPIA_SERVICES.lib:BCS.o(.data)
      */BLUETOPIA_SERVICES.lib:BLS.o(.data)
      */BLUETOPIA_SERVICES.lib:BMS.o(.data)
      */BLUETOPIA_SERVICES.lib:CGMS.o(.data)
      */BLUETOPIA_SERVICES.lib:CSCS.o(.data)
      */BLUETOPIA_SERVICES.lib:CTS.o(.data)
      */BLUETOPIA_SERVICES.lib:ESS.o(.data)
      */BLUETOPIA_SERVICES.lib:GAPS.o(.data)
      */BLUETOPIA_SERVICES.lib:GLS.o(.data)
      */BLUETOPIA_SERVICES.lib:HIDS.o(.data)
      */BLUETOPIA_SERVICES.lib:HPS.o(.data)
      */BLUETOPIA_SERVICES.lib:HRS.o(.data)
      */BLUETOPIA_SERVICES.lib:HTS.o(.data)
      */BLUETOPIA_SERVICES.lib:IPS.o(.data)
      */BLUETOPIA_SERVICES.lib:LNS.o(.data)
      */BLUETOPIA_SERVICES.lib:OTS.o(.data)
      */BLUETOPIA_SERVICES.lib:PASS.o(.data)
      */BLUETOPIA_SERVICES.lib:PLXS.o(.data)
      */BLUETOPIA_SERVICES.lib:RSCS.o(.data)
      */BLUETOPIA_SERVICES.lib:SCPS.o(.data)
      */BLUETOPIA_SERVICES.lib:TRDS.o(.data)
      */BLUETOPIA_SERVICES.lib:UDS.o(.data)
      */BLUETOPIA_SERVICES.lib:WSS.o(.data)
      */BLUETOPIA_QAPI_SERVICES.lib:SLoWP.o(.data)
      */otp_tlv.lib:otp_tlv_read.o(.data)
      */otp_tlv.lib:dbgcall.o(.data)
      */wlan_lib_common_xip.lib:wlan_lib_port.o(.data)
      */wlan_lib_common_xip.lib:wlan_lib_dbg.o(.data)
      */tlv_transport.lib:tlv_transport.o(.data)
      */dnsclient.lib:dnsclnt.o(.data)
      */securefs.lib:securefs.o(.data)
      */securefs.lib:securefs_hmac.o(.data)
      */v2core.lib:ram_function_table_fom.o(RAM_FOM_BSP_ROM2RAM_INDIRECTION_TABLE_RW_SECTION_0)
      */EDLManager.lib:EDLManager.o(.data)
      */QCA4020_2p0_CDB_NVM.lib:QCA4020_2p0_CDB_NVM.o(.data)
      */patch.lib:patch_ssl_ram.o(.data)
      */patch.lib:patch_SharkSslCon_DTLS.o(.data)
      */patch.lib:patch_SharkSSLCon.o(.data)
      */patch.lib:patch_hmac_aes.o(.data)
      */patch.lib:patch_SharkSslCryptoLib.o(.data)
      */patch.lib:patch_iprcv.o(.data)
      */patch.lib:patch_ssl.o(.data)
      *(RAM_FOM_BSP_RW_SECTION) 
   } >RAM_FOM_BSP_DATA_MEMORY : RAM_FOM_BSP_DATA_SEGMENT

   /* RAM_FOM_APPS_DATA_SEGMENT */

   RAM_FOM_APPS_RW_REGION :
   {
      *(RAM_FOM_APPS_RW_SECTION)
      */core.lib:usb_client_loopback_diag.o(.data)
      */core.lib:usb_isr.o(.data)
      */core.lib:core_test_m4f.o(.data)
      */qcli.o(.data)
      */qcli_util.o(.data)
      */pal.o(.data)
      */spple_demo.o(.data)
      */ble_ota_service.o(.data)
      */sensors_demo.o(.data)
      */sensors.o(.data)
      */lp_demo.o(.data)
      */fom_lp_test.o(.data)
      */platform_oem.o(.data)
      */UsrEDL.o(.data)
      *(.data)
   } >RAM_FOM_APPS_DATA_MEMORY : RAM_FOM_APPS_DATA_SEGMENT
   
   RAM_FOM_APPS_ZI_REGION :
   {
      _RAM_FOM_APPS_ZI_START = .;
      *(COMMON)
      *(RAM_FOM_APPS_ZI_SECTION)
      */core.lib:usb_client_loopback_diag.o(.bss)
      */core.lib:usb_client_loopback_diag.o(COMMON)
      */core.lib:usb_client_util.o(.bss)
      */core.lib:usb_client_util.o(COMMON)
      */core.lib:usb_mem_util.o(.bss)
      */core.lib:usb_mem_util.o(COMMON)
      */core.lib:usb_os_util.o(.bss)
      */core.lib:usb_os_util.o(COMMON)
      */core.lib:usb_al_hlos_bulk.o(.bss)
      */core.lib:usb_al_hlos_bulk.o(COMMON)
      */core.lib:usb_wrapper_api.o(.bss)
      */core.lib:usb_wrapper_api.o(COMMON)
      */core.lib:usb_isr.o(.bss)
      */core.lib:usb_isr.o(COMMON)
      */core.lib:core_test_m4f.o(.bss)
      */core.lib:core_test_m4f.o(COMMON)
      */core.lib:reboot_test.o(.bss)
      */core.lib:reboot_test.o(COMMON)
      */qcli.o(.bss)
      */qcli.o(COMMON)
      */qcli_util.o(.bss)
      */qcli_util.o(COMMON)
      */pal.o(.bss)
      */pal.o(COMMON)
      */spple_demo.o(.bss)
      */spple_demo.o(COMMON)
      */ble_ota_service.o(.bss)
      */ble_ota_service.o(COMMON)
      */sensors_demo.o(.bss)
      */sensors_demo.o(COMMON)
      */sensors.o(.bss)
      */sensors.o(COMMON)
      */lp_demo.o(.bss)
      */lp_demo.o(COMMON)
      */fom_lp_test.o(.bss)
      */fom_lp_test.o(COMMON)
      */platform_oem.o(.bss)
      */platform_oem.o(COMMON)
      */UsrEDL.o(.bss)
      */UsrEDL.o(COMMON)
      *(.bss)
      _RAM_FOM_APPS_ZI_END = ALIGN(0x100);      
   } >RAM_FOM_APPS_DATA_MEMORY : RAM_FOM_APPS_DATA_SEGMENT  
   .ARM.exidx :
   {
      *(.ARM.exidx*)
   } >XIP_RO_MEMORY : XIP_SEGMENT
}

/* Export symbols. */
Image$$RAM_SOM_BSP_ZI_REGION$$ZI$$Base        = _RAM_SOM_BSP_ZI_START;
Image$$RAM_SOM_BSP_ZI_REGION$$ZI$$Length      = _RAM_SOM_BSP_ZI_END - _RAM_SOM_BSP_ZI_START;

Image$$RAM_SBL_RO_REGION$$RW$$Base            = ORIGIN(RAM_SBL_RO_MEMORY);
Image$$RAM_SBL_RO_REGION$$RW$$Limit           = LENGTH(RAM_SBL_RO_MEMORY);

Image$$RAM_FOM_BSP_ZI_REGION$$ZI$$Base            = ORIGIN(RAM_FOM_BSP_DATA_MEMORY);
Image$$RAM_FOM_BSP_ZI_REGION$$ZI$$Length          = LENGTH(RAM_FOM_BSP_DATA_MEMORY);

Image$$SBL_LOG_META_INFO_RW_SECTION$$Base     = ORIGIN(SBL_LOG_META_INFO_RW_MEMORY);
Image$$SBL_LOG_BUF_RW_SECTION$$Base           = ORIGIN(SBL_LOG_BUF_RW_MEMORY);

Image$$RAM_SOM_BSP_HEAP_REGION$$ZI$$Base         = ORIGIN(RAM_SOM_BSP_HEAP_MEMORY);
Image$$RAM_SOM_BSP_HEAP_REGION$$ZI$$Length       = LENGTH(RAM_SOM_BSP_HEAP_MEMORY);

Image$$RAM_SOM_BSP_HEAP_ZI_REGION$$ZI$$Base      = ORIGIN(RAM_SOM_BSP_HEAP_MEMORY);
Image$$RAM_SOM_BSP_HEAP_ZI_REGION$$ZI$$Length    = LENGTH(RAM_SOM_BSP_HEAP_MEMORY);


Image$$RAM_SOM_APPS_ZI_REGION$$ZI$$Base          = _RAM_SOM_APPS_ZI_START;
Image$$RAM_SOM_APPS_ZI_REGION$$ZI$$Length        = _RAM_SOM_APPS_ZI_END - _RAM_SOM_APPS_ZI_START;

Image$$RAM_FOM_APPS_ZI_REGION$$ZI$$Base          = _RAM_FOM_APPS_ZI_START;
Image$$RAM_FOM_APPS_ZI_REGION$$ZI$$Length        = _RAM_FOM_APPS_ZI_END - _RAM_FOM_APPS_ZI_START;

Image$$RAM_AON_MOM_ZI_REGION$$ZI$$Base           = ORIGIN(RAM_AON_DATA_MEMORY);
Image$$RAM_AON_MOM_ZI_REGION$$ZI$$Length         = LENGTH(RAM_AON_DATA_MEMORY);

Load$$RAM_SOM_BSP_ZI_REGION$$ZI$$Base            = _RAM_SOM_BSP_ZI_START;
Load$$RAM_SOM_BSP_HEAP_ZI_REGION$$ZI$$Base       = ORIGIN(RAM_SOM_BSP_HEAP_MEMORY);
Load$$RAM_SOM_APPS_ZI_REGION$$ZI$$Base           = _RAM_SOM_APPS_ZI_START;
Load$$RAM_FOM_BSP_ZI_REGION$$ZI$$Base            = ORIGIN(RAM_FOM_BSP_DATA_MEMORY);
Load$$RAM_FOM_APPS_ZI_REGION$$ZI$$Base           = _RAM_FOM_APPS_ZI_START;

Image$$RAM_SOM_BSP_DIAG_BUF_REGION$$ZI$$Base     = ORIGIN(RAM_SOM_BSP_DIAG_BUF_MEMORY);
Image$$RAM_SOM_BSP_DIAG_BUF_REGION$$ZI$$Length   = LENGTH(RAM_SOM_BSP_DIAG_BUF_MEMORY);

Image$$RAM_SOM_BSP_STACK_REGION$$ZI$$Base        = ORIGIN(RAM_SOM_BSP_STACK_MEMORY);
Image$$RAM_SOM_BSP_STACK_REGION$$ZI$$Limit       = ORIGIN(RAM_SOM_BSP_STACK_MEMORY) + LENGTH(RAM_SOM_BSP_STACK_MEMORY);

/*FOM HEAP begins at the end of FOM_APP_DATA region that is used-up by the application, an increase
in data usage will decrease HEAP and vice-versa*/ 
RTOS_HEAP_SIZE	= 0x0;
Image$$RAM_FOM_BSP_RTOS_HEAP_REGION$$ZI$$Base	 = _RAM_FOM_APPS_ZI_END;	
Image$$RAM_FOM_BSP_HEAP_REGION$$ZI$$Base         = RTOS_HEAP_SIZE + Image$$RAM_FOM_BSP_RTOS_HEAP_REGION$$ZI$$Base;
Image$$RAM_FOM_BSP_STACK_REGION$$ZI$$Base        = ORIGIN(RAM_FOM_BSP_STACK_MEMORY);
Image$$RAM_FOM_BSP_STACK_REGION$$ZI$$Limit       = ORIGIN(RAM_FOM_BSP_STACK_MEMORY) + LENGTH(RAM_FOM_BSP_STACK_MEMORY);

/*Following symbols should be retained as undefined symbols*/
EXTERN(
qca_init 
gTsensBsp_devcfg_xml 
gAdcBsp_devcfg_xml 
quartz_ram_function_table 
wlan_secboot_auth 
mom_indirection_table 
som_indirection_table 
fom_indirection_table 
ram_function_table 
ram_function_table_som 
ram_function_table_mom
gTsensBsp_qca4020_devcfg_xml 
gAdcBsp_qca4020_devcfg_xml 
spi_first_port_qca4020_devcfg_xml 
I2CCoreConfig01_qca4020_devcfg_xml 
uart_first_port_qca4020_devcfg_xml 
gGPIOIntConfigTable_qca4020_devcfg_xml 
IPCIntConfig_qca4020_devcfg_xml 
InterruptControllerPriorityConfig_qca4020_devcfg_xml 
IPCIntIRQData_qca4020_devcfg_xml 
I2CCoreConfig02_qca4020_fom_xml  
spi_second_port_qca4020_fom_xml 
uart_second_port_qca4020_fom_xml 
platFlashPwrData_qca4020_fom_xml 
platThreadConfig_qca4020_fom_xml 
DALPROP_PropBin_qca4020_devcfg_xml 
DALPROP_StructPtrs_qca4020_devcfg_xml 
DALPROP_StructPtrs_qca4020_fom_xml 
DALPROP_PropBin_qca4020_fom_xml 
DALPROP_PropsInfo_qca4020_devcfg_xml 
DALPROP_PropsInfo_qca4020_fom_xml
gTsensBsp_qca4024_devcfg_xml 
gAdcBsp_qca4024_devcfg_xml 
spi_first_port_qca4024_devcfg_xml 
I2CCoreConfig01_qca4024_devcfg_xml 
uart_first_port_qca4024_devcfg_xml 
gGPIOIntConfigTable_qca4024_devcfg_xml 
IPCIntConfig_qca4024_devcfg_xml 
InterruptControllerPriorityConfig_qca4024_devcfg_xml 
IPCIntIRQData_qca4024_devcfg_xml 
I2CCoreConfig02_qca4024_fom_xml  
spi_second_port_qca4024_fom_xml 
uart_second_port_qca4024_fom_xml 
platFlashPwrData_qca4024_fom_xml 
platThreadConfig_qca4024_fom_xml 
DALPROP_PropBin_qca4024_devcfg_xml 
DALPROP_StructPtrs_qca4024_devcfg_xml 
DALPROP_StructPtrs_qca4024_fom_xml 
DALPROP_PropBin_qca4024_fom_xml 
DALPROP_PropsInfo_qca4024_devcfg_xml 
DALPROP_PropsInfo_qca4024_fom_xml
gTsensBsp_qca4025_devcfg_xml 
gAdcBsp_qca4025_devcfg_xml 
spi_first_port_qca4025_devcfg_xml 
I2CCoreConfig01_qca4025_devcfg_xml 
uart_first_port_qca4025_devcfg_xml 
gGPIOIntConfigTable_qca4025_devcfg_xml 
IPCIntConfig_qca4025_devcfg_xml 
InterruptControllerPriorityConfig_qca4025_devcfg_xml 
IPCIntIRQData_qca4025_devcfg_xml 
I2CCoreConfig02_qca4025_fom_xml  
spi_second_port_qca4025_fom_xml 
uart_second_port_qca4025_fom_xml 
platFlashPwrData_qca4025_fom_xml 
platThreadConfig_qca4025_fom_xml 
DALPROP_PropBin_qca4025_devcfg_xml 
DALPROP_StructPtrs_qca4025_devcfg_xml 
DALPROP_StructPtrs_qca4025_fom_xml 
DALPROP_PropBin_qca4025_fom_xml 
DALPROP_PropsInfo_qca4025_devcfg_xml 
DALPROP_PropsInfo_qca4025_fom_xml
)
